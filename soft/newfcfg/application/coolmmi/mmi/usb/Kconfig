## soft/newfcfg/application/coolmmi/mmi/usb/Kconfig
```kconfig
comment "--- application/coolmmi/mmi/usb ---"

config __MMI_USB_SUPPORT__
    option skipmk
    bool "MMI USB support"
    default y
    ---help---
        This option enables MMI USB support.

config __USB_ENABLE__
    option skipmk
    bool "USB feature Enable"
    def_bool y if __MMI_USB_SUPPORT__

config __MMI_EXT_DEVICE__
    option skipmk
    bool "MMI external device support"
    def_bool y if __USB_ENABLE__ || __BTCOOLSAND__ || __IRDA_SUPPORT__
	def_bool n
```

## soft/newfcfg/application/coolmmi/mmi/wapmms/Kconfig
```kconfig
comment "--- GPRS Options ---"

menuconfig MMI_GPRS_ENABLE
	option skiph
	option skipmk
	depends on GPRS_SUPPORT
	bool "MMI GPRS SUPPORT"
	default y
	---help---
		Only it set to yes, you can define to support MMI_SUPPORT_GPRS MMI WAP and MMI MMS.

if MMI_GPRS_ENABLE
config MMI_SUPPORT_GPRS
	option skiph
	bool "MMI GPRS Support"
	default y
	---help---
		This option enables MMI GPRS support. Only it set to yes, you can define to support MMI WAP and MMI MMS.

config __MMI_GPRS_FEATURES__
	option skipmk
	def_bool y if MMI_SUPPORT_GPRS
	def_bool n

config MMI_SUPPORT_WAP
	option skiph
	bool "MMI WAP Support"
	depends on MMI_SUPPORT_GPRS
	default y
	---help---
		This option enables MMI WAP support. 

config RWAPMMS_SUPPORT_WAP
	option skipmk
	def_bool y if MMI_SUPPORT_WAP
	def_bool n

config MMI_SUPPORT_MMS
	option skiph
	bool "MMI MMS Support"
	depends on MMI_SUPPORT_GPRS
	default y
	---help---
		This option enables MMI MMS support. 

config RWAPMMS_SUPPORT_MMS
	option skipmk
	def_bool y if MMI_SUPPORT_MMS
	def_bool n

config MMI_SUPPORT_WAPMMS
	option skiph
	def_bool y if MMI_SUPPORT_WAP || MMI_SUPPORT_MMS
	def_bool n

config RWAPMMS_SUPPORT
	option skipmk
	def_bool y if MMI_SUPPORT_WAPMMS
	def_bool n

config MMI_SUPPORT_JAT_SEC
	option skiph
	bool "WAP and MMS Security"
	default y
	---help---
		This option enables security function of WAP and MMS. 

config RWAPMMS_SUPPORT_SECURITY
	option skipmk
	def_bool y if MMI_SUPPORT_JAT_SEC
	def_bool n

config MMI_SUPPORT_JAT_OTA
	option skiph
	bool "WAP and MMS OTA"
	depends on MMI_SUPPORT_WAPMMS
	default y
	---help---
		This option enables OTA function of WAP and MMS. 

config RWAPMMS_SUPPORT_OTA
	option skipmk
	def_bool y if MMI_SUPPORT_JAT_OTA
	def_bool n

config MMI_SUPPORT_JAT_OMA_DLD
	option skiph
	bool "WAP and MMS OMA Download"
	depends on MMI_SUPPORT_WAPMMS
	default y
	---help---
		This option enables OMA download function of WAP and MMS. 

config RWAPMMS_SUPPORT_OMA_DOWNLOAD
	option skipmk
	def_bool y if MMI_SUPPORT_JAT_OMA_DLD
	def_bool n

config MMI_SUPPORT_WAPPUSH
	option skiph
	bool "WAP Push Enable"
	default n
	---help---
		This option enables WAP Push function of WAP and MMS. 

config JWAP_PUSH_ENABLE
	option skipmk
	def_bool y if MMI_SUPPORT_WAPPUSH
	def_bool n

config MMI_USING_SLIM_WAPMMS
	option skiph
	bool "MMI_USING_SLIM_WAPMMS"
	depends on MMI_SUPPORT_WAPMMS
	default y
	---help---
		This option enables use the slim version of WAP and MMS. 

config RWAPMMS_USING_SLIM_WAPMMS
	option skipmk
	def_bool y if MMI_USING_SLIM_WAPMMS
	def_bool n

config RWAPMMS_USING_FULL_WAPMMS
	option skipmk
	def_bool n if MMI_USING_SLIM_WAPMMS
	def_bool y

choice MMS_SAVE_PATH
	option enum
	option skiph
	option skipmk
	prompt "MMS save :"
	default MMS_SAVE_AUTO
	---help---
	   save MMS files in TCard or Phone
	
	config MMS_SAVE_AUTO
		option skiph
		option skipmk
		bool "Auto"

	config MMS_SAVE_TCARD
		option skiph
		option skipmk
		bool "TCard"

	config MMS_SAVE_PHONE
		option skiph
		option skipmk
		bool "Phone"
endchoice

config MMS_IN_ME_OR_TCARD
	option skipmk
	def_bool y if MMI_SUPPORT_MMS && MMS_SAVE_AUTO
	def_bool n

config MMS_IN_TCARD
	option skipmk
	def_bool y if MMI_SUPPORT_MMS && MMS_SAVE_TCARD
	def_bool n

choice WAP_SAVE_PATH
	option enum
	option skiph
	option skipmk
	prompt "WAP save :"
	default WAP_SAVE_AUTO
	---help---
	   save WAP files in TCard or Phone
	
	config WAP_SAVE_AUTO
		option skiph
		option skipmk
		bool "Auto"

	config WAP_SAVE_TCARD
		option skiph
		option skipmk
		bool "TCard"

	config WAP_SAVE_PHONE
		option skiph
		option skipmk
		bool "Phone"
endchoice

config JWAP_IN_ME_OR_TCARD
	option skipmk
	def_bool y if MMI_SUPPORT_WAP && WAP_SAVE_AUTO
	def_bool n

config JWAP_IN_TCARD
	option skipmk
	def_bool y if MMI_SUPPORT_WAP && WAP_SAVE_TCARD
	def_bool n

config WAP_CACHE_IN_TFLASH
	option skiph
	bool "Wap Cache in TFlash"
	default n
	---help---
		This option enables save WAP cache in Tflash. 

config WAP_DOWLOAD_PATH
	option skipmk
	bool "WAP DOWLOAD PATH"
	depends on MMI_SUPPORT_JAT_OMA_DLD
	default n

config RWAPMMS_DATA_STORAGE_MANAGE
	option skipmk
	bool "RWAPMMS DATA STORAGE MANAGE"
	depends on MMI_SUPPORT_GPRS
	default n

config __MMI_WAP__
	option skipmk
	def_bool y if MMI_SUPPORT_WAP && !__MMI_FILE_MANAGER__

config __RWAPMMS_AUTO_CFG_DATAACCOUNT_SUPPORT__
	option skipmk
	bool "__RWAPMMS_AUTO_CFG_DATAACCOUNT_SUPPORT__"
	default y
	---help---
	    This option enables GPRS browser can auto config with the operator.

endif
```

## soft/newfcfg/application/coolmmi/mmi_csdapp/analogtv/Kconfig
```kconfig
comment "--- application/coolmmi/mmi_csdapp/analogtv ---"

config ANALOG_TV_SUPPORT
	option skiph
	bool "Analog TV"
	default n
	---help---
		This option enables analog TV support. 

config __MMI_ANALOGTV__
	option skipmk
	def_bool y if ANALOG_TV_SUPPORT
	def_bool n

config ANALOG_TV_SUPPORT_MCP_LOCK
	option skipmk
	bool "ATV support mcp lock"
	depends on ANALOG_TV_SUPPORT
	def_bool y
```

## soft/newfcfg/application/coolmmi/mmi_csdapp/audioplayer/Kconfig
```kconfig
comment "--- application/coolmmi/mmi_csdapp/audioplayer ---"

config FMGR_AUDIO_PLAYER_SUPPORT
	option skipmk
	bool "FMGR_AUDIO_PLAYER_SUPPORT"
	default y
	---help---
		It enables audio player support. 

config __AUDPLY_SUPPORT_VIDEO_FORMAT__
	option skipmk
	bool "AUDPLY_SUPPORT_VIDEO_FORMAT"
	default y
	---help---
		It enables playing video format file in auodio player. 

#config AUDIO_PLAYER_SUPPORT
#	option skipmk
#	bool "AUDIO_PLAYER_SUPPORT"
#	default y if TARGET_MEM_ULC_3216
#	default y
#
#config __MMI_AUDIO_PLAYER__
#	option skipmk
#	bool "MMI Audio player screen"
#	depends on AUDIO_PLAYER_SUPPORT && DAF_DECODE
#	default y
#
#config __MMI_AUDIO_PLAYER_DETAIL_SHOW_MORE_INFO__
#	option skipmk
#	bool "MMI Audio player show more detail info"
#	depends on AUDIO_PLAYER_SUPPORT && DAF_DECODE
#	default y
#
#config __MMI_AUDIO_PLAYER_ANIMATION__
#	option skipmk
#	bool "MMI Audio player show animation"
#	depends on AUDIO_PLAYER_SUPPORT && DAF_DECODE && (__MMI_MAINLCD_176X220__ || __MMI_MAINLCD_220X176__)
#	default y
#
#config __MMI_AUDIO_PLAYER_SKIN_SHOW_REPEAT_SHUFFLE__
#	option skipmk
#	bool "MMI Audio player skin show repeat shuffle"
#	depends on AUDIO_PLAYER_SUPPORT && DAF_DECODE && __MMI_MAINLCD_220X176__
#	default y
#

config MULTI_MEDIA_AMR_SUPPORT
	option skiph
	bool "MULTI_MEDIA_AMR_SUPPORT"
	default y
	---help---
		It enables AMR support in multimedia. 

config AMR_NOT_SUPPORT
	option skipmk
	bool
	default n if MULTI_MEDIA_AMR_SUPPORT
	default y
	---help---
		It enables No AMR support in multimedia. 

config MMI_SUPPORT_MAGIC_SOUND
	option skiph
	bool "Magic Sound"
	default n
	---help---
		It enables magic sound support. If set at YES, MAGIC_AE_SUPPORT will work and the third part lib (JT_MAGIC_SOUND_SUPPORT / XF_MAGIC_SOUND_SUPPORT) should be configured.

config MAGIC_AE_SUPPORT
	option skipmk
	def_bool y if MMI_SUPPORT_MAGIC_SOUND
	def_bool n

config __AUDPLY_SUPPORT_M4A_ONLY_WITH_VIDPLY__
	option skipmk
	bool "__AUDPLY_SUPPORT_M4A_ONLY_WITH_VIDPLY__"
	default y
	---help---
		It enables show M4A file in video player.
```

## soft/newfcfg/application/coolmmi/mmi_csdapp/camera/Kconfig
```kconfig
comment "--- application/coolmmi/mmi_csdapp/camera ---"

config __MMI_CAMERA__
	option skipmk
	bool "MMI CAMERA"
	default y if CAMERA_MODULE || ISP_SUPPORT
	---help---
        This option enables Camera application and Image Viewer application.

config __MMI_CAMERA_FEATURE_WATCHDOG_TIMEOUT__
	option skipmk
	bool "Camera watchdog"
	default y if CAMERA_MODULE || ISP_SUPPORT
	---help---
            This option enables camera can exit previewing state if no operation in specific time.

config __CAMERA_FEATURE_EV__
	option skipmk
	bool "__CAMERA_FEATURE_EV__"
	default n

#config __MMI_WEBCAM__
#	option skipmk
#	bool "Webcamera mmi support"
#	default y if WEBCAM_SUPPORT
#

config __MMI_DISABLE_DUAL_SENSOR__
	option skipmk
	def_bool n if SUPPORT_DUAL_CAMERA
	def_bool y

#config HORIZONTAL_CAMERA
#	option skipmk
#	bool "Camera app support screen rotation"
#	default n
#
#config __MMI_SCREEN_ROTATE__
#	option skipmk
#	bool "Support screen rotation"
#	depends on HORIZONTAL_CAMERA
#	default y
#
#config __MMI_SCREEN_ROTATE_DEGREE_270__
#	option skipmk
#	bool "Supports screen rotation of 270 degree"
#	depends on HORIZONTAL_CAMERA
#	default y

config __CAMERA_FEATURE_EFFECT__
	option skipmk
	bool "CAMERA_FEATURE_EFFECT"
	default y
	---help---
	    This option enables effect feature for camera application.

config __CAMERA_FEATURE_EFFECT_NORMAL__
	option skipmk
	bool "CAMERA_FEATURE_EFFECT_NORMAL"
	default y
	---help---
	    This option enables effect feature contains normal mode for camera application.

config __CAMERA_FEATURE_EFFECT_ANTIQUE__
	option skipmk
	bool "CAMERA_FEATURE_EFFECT_ANTIQUE"
	default y
	---help---
	    This option enables effect feature contains antique mode for camera application.

config __CAMERA_FEATURE_EFFECT_REDRISH__
	option skipmk
	bool "CAMERA_FEATURE_EFFECT_REDRISH"
	default y
	---help---
	    This option enables effect feature contains red filter mode for camera application.

config __CAMERA_FEATURE_EFFECT_GREENRISH__
	option skipmk
	bool "CAMERA_FEATURE_EFFECT_GREENRISH"
	default y
	---help---
	    This option enables effect feature contains green filter mode for camera application.

config __CAMERA_FEATURE_EFFECT_BLUERISH__
	option skipmk
	bool "CAMERA_FEATURE_EFFECT_BLUERISH"
	default y
	---help---
	    This option enables effect feature contains blue filter mode for camera application.

config __CAMERA_FEATURE_EFFECT_BLACKWHITE__
	option skipmk
	bool "CAMERA_FEATURE_EFFECT_BLACKWHITE"
	default y
	---help---
	    This option enables effect feature contains black-and-white mode for camera application.

config __CAMERA_FEATURE_EFFECT_NEGATIVE__
	option skipmk
	bool "CAMERA_FEATURE_EFFECT_NEGATIVE"
	default y
	---help---
	    This option enables effect feature contains negative mode for camera application.

config __CAMERA_FEATURE_CONTRAST__
	option skipmk
	bool "CAMERA_FEATURE_CONTRAST"
	default y
	---help---
	    This option enables contrast feature for camera application.

config __CAMERA_FEATURE_AUTO_SAVE__
	option skipmk
	bool "CAMERA_FEATURE_AUTO_SAVE"
	default y
	---help---
	    This option enables auto save feature for camer application.	

config __CAMERA_FEATURE_WB__
	option skipmk
	bool "CAMERA_FEATURE_WB"
	default y
	---help---
	    This option enables white balance feature for camera application.

config __CAMERA_FEATURE_CONT_SHOT__
	option skipmk
	bool "CAMERA_FEATURE_CONT_SHOT"
	default y
	---help---
	    This option enables continuous shooting feature for camera application.

config __CAMERA_FEATURE_BANDING__
	option skipmk
	bool "CAMERA_FEATURE_BANDING"
	default y
	---help---
	    This option enables anti-banding feature for camera application.

config CAMERA_SUPPORT_PREVIEW_WITHOUT_TFLASH
	option skipmk
	bool "CAMERA_SUPPORT_PREVIEW_WITHOUT_TFLASH"
	default n
	---help---
	    This option enables preview without Tflash feature does not need check state for init preview.

config CAM_MD_SUPPORT
	bool "CAM_MD_SUPPORT"
	depends on !CAMERA_MODEL
	default n
	---help---
	    This option enables motion detection feature for camera app.
```

## soft/newfcfg/application/coolmmi/mmi_csdapp/engineermode/Kconfig
```kconfig
comment "--- application/coolmmi/mmi_csdapp/engineermode ---"

config __MMI_ENGINEER_MODE__
    option skipmk
    bool "MMI_ENGINEER_MODE"
    default y
    ---help---
        This option enables engineering mode.

config __MMI_EM_AUDIO_SPEECH_ENHANCEMENT__
    option skipmk
    bool "MMI_EM_AUDIO_SPEECH_ENHANCEMENT"
    default y
    ---help---
       This option enables audio speech enhanacement test of engineering mode.
```

## soft/newfcfg/application/coolmmi/mmi_csdapp/filemgr/Kconfig
```kconfig
comment "--- application/coolmmi/mmi_csdapp/filemgr ---"

config FMGR_USING_CACHE
	option skipmk
	bool "FMGR_USING_CACHE"
	default y
	---help---
		This option enables saving image thumbnail feature in file mangement application.

config __SUPPORT_MEMORY_CARD_RENAME__
    option skipmk
    bool "SUPPORT_MEMORY_CARD_RENAME"
    default y
	---help---
		This option enables rename memeory card feature.

config __MMI_IMAGEVIEWER_MARK_SEVERAL__
	option skipmk
	bool "MMI_IMAGEVIEWER_MARK_SEVERAL"
	def_bool y
	---help---
		This option enables mark several feature in image viewer application.

config __MMI_FILEMANAGER_MARK_SEVERAL__
	option skipmk
	bool "MMI_FILEMANAGER_MARK_SEVERAL"
	def_bool y
	---help---
		This option enables mark several feature in file management application.

#config __MMI_DATA_STORE__
#	option skipmk
#	bool "MMI datat store"
#	default y
#
#config CAT222_IMAGE_FIT_CONTENT_SIZE
#	option skipmk
#	bool "CAT222_IMAGE_FIT_CONTENT_SIZE"
#	default y
#	---help---
#	define for display the capacity of file system

config __MMI_FILE_MANAGER__
	option skipmk
	bool "MMI support file management"
	default y
	---help---
		This option enables MMI file management function.


#config __MMI_SHOW_FILE_EXT__
#	option skipmk
#	bool "MMI support show file ext"
#	default y
#
#config __MMI_SLIM_FILE_MANAGER__
#	option skipmk
#	bool "MMI support slim file manager"
#	default y
#
#config __MMI_MEMORY_CARD_SUPPORT__
#	option skipmk
#	bool "MMI support memory card"
#	default y

config MMI_MULTIMEDIA_USE_FLASHFS
	option skipmk
	bool "MMI_MULTIMEDIA_USE_FLASHFS"
	default y
	---help---
		This option supports multimedia (audioplayer/image viewer/camera/sound recorder/file management) using memcory card.
```

## soft/newfcfg/application/coolmmi/mmi_csdapp/fmradio/Kconfig
```kconfig
config __MMI_FM_RADIO__
	option skipmk
	def_bool y if FM_RADIO_ENABLE
	def_bool n

config __MMI_FM_RADIO_RECORD__
	option skipmk
	def_bool y if FM_RADIO_RECORD
	def_bool n

config __MMI_FM_RADIO_SCHEDULE_REC__
	option skipmk
	def_bool y if FM_RADIO_RECORD
	def_bool n

config __MMI_FM_RECORD_ONLY_SUPPORT_WAV__
	option skipmk
	def_bool y if FM_RADIO_RECORD
	def_bool n

config __MMI_FM_RADIO_BIND_EARPHONE__
	option skipmk
	def_bool n if FM_RADIO_WITH_EXTERNAL_ANT
	def_bool y

config __MMI_FM_RADIO_ANIMATION__
	option skipmk
	bool "Radio Animation (only support 240x320)"
	depends on FM_RADIO_ENABLE
	default n
```

## soft/newfcfg/application/coolmmi/mmi_csdapp/video/Kconfig
```kconfig
config __MMI_VIDEO_RECORDER__
	option skipmk
	def_bool y if VIDEO_RECORDER_SUPPORT
	def_bool n

config __MED_MJPG_AUDIO__
	option skipmk
	def_bool y if VIDEO_RECORDER_SUPPORT
	def_bool n

#if VIDEO_RECORDER_SUPPORT
#
#config __MMI_VIDEO_RECORDER__
#	option skipmk
#	bool
#	default y
#
#config __MED_MJPG_AUDIO__
#	option skipmk
#	bool
#	default y
#
#endif
#
#config __MMI_VIDEO__
#	option skipmk
#	def_bool y if VIDEO_PLAYER_SUPPORT
#
#config __MMI_VIDEO_PLAYER__
#	option skipmk
#	bool "MMI video player screen"
#	depends on VIDEO_PLAYER_SUPPORT
#	default y
config MEDIA_H264_SUPPORT
	bool "MEDIA_H264_SUPPORT"
	default n
	---help---
		This option enables video player supports H264 format file.

config MEDIA_VOCVID_SUPPORT
	bool "MEDIA_VOCVID_SUPPORT"
	default y
	---help---
		This option enables voc decoder function for video.

config __MMI_PLAYER_LEFT_KEY_OPTION__
	option skipmk
	bool "__MMI_PLAYER_LEFT_KEY_OPTION__"
	default n
	---help---
		This option enables enter HELP screen by left key in video player.
```
