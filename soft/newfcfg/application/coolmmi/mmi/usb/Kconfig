## soft/newfcfg/application/diag/Kconfig
```kconfig
comment "--- application/diag ---"
if _UCDCACM_
config SUPPORT_SPRD_BBAT
    bool "SUPPORT_SPRD_BBAT"
    default y
    ---help---
    Support SPRD BBAT

config SUPPORT_QUICK_VCOM
    option skipmk
    bool "SUPPORT_QUICK_VCOM"
	depends on SUPPORT_SPRD_BBAT
    default y
endif
```

## soft/newfcfg/application/target_res/Kconfig
```kconfig
comment "--- application/target_res ---"

menu "Language"
source "newfcfg/application/target_res/Kconfig.lang"
endmenu

menu "Inputmethod"
source "newfcfg/application/target_res/Kconfig.im"
endmenu

menu "Fonts"
source "newfcfg/application/target_res/Kconfig.font"
endmenu

choice CT_ERES
    option enum
    option skiph
    prompt "CT_ERES"
    default qqvga_3232

    config qqvga_3232
    option skiph
    bool "qqvga_3232"

    config qvga_3264
    option skiph
    bool "qvga_3264"

    config qcif_3264
    option skiph
    bool "qcif_3264"

    config 128_128
    option skiph
    bool "128_128"
	
    config 160_128_3216
    option skiph
    bool "160_128_3216"

    config 220_176_3232
    option skiph
    bool "220_176_3232"

    config 320_240_6432
    option skiph
    bool "320_240_6432"

    config 240_240
    option skiph
    bool "240_240"
endchoice

config TARGET_MEM_ULC_3216
    bool "TARGET_MEM_ULC_3216"
    option skiph
    default y
    ---help---
        If yes, below Macro will be defined by default:
            FLASH_OPT
            MMI_ULC
            MEM_ULC_3216
            __MMI_RESOURCE_SLIM_ON_128X160__
            __MMI_RESOURCE_SLIM_AUD_SOURCE__
            __MMI_FM_SLIM_SKIN__
            __MMI_SLIM_LISTMENU_NUMBER__
            SLIM_AUDIO_PROFILE
            __SLIM_EMS__
            __MMI_SLIM_PROGRESS_ANIMATION__
            DAF_DECODE
            AUDIO_PLAYER_SUPPORT
        If no, below Macro will be defined by default:
            __MMI_EBOOK_READER__
            USE_SW_PNG_DECODER

config FLASH_OPT
    option skipmk
    def_bool y if TARGET_MEM_ULC_3216
    def_bool n

config MMI_ULC
    option skipmk
    def_bool y if TARGET_MEM_ULC_3216
    def_bool n

config MEM_ULC_3216
    option skipmk
    def_bool y if TARGET_MEM_ULC_3216
    def_bool n

config __MMI_RESOURCE_SLIM_ON_128X160__
    option skipmk
    def_bool y if TARGET_MEM_ULC_3216
    def_bool n

config __MMI_RESOURCE_SLIM_AUD_SOURCE__
    option skipmk
    def_bool y if TARGET_MEM_ULC_3216
    def_bool n

config __MMI_FM_SLIM_SKIN__
    option skipmk
    def_bool y if TARGET_MEM_ULC_3216
    def_bool n

config __MMI_SLIM_LISTMENU_NUMBER__
    option skipmk
    def_bool y if TARGET_MEM_ULC_3216
    def_bool n

config SLIM_AUDIO_PROFILE
    option skipmk
    def_bool y if TARGET_MEM_ULC_3216
    def_bool n

config __SLIM_EMS__
    option skipmk
    def_bool y if TARGET_MEM_ULC_3216
    def_bool n

config __MMI_SLIM_PROGRESS_ANIMATION__
    option skipmk
    def_bool y if TARGET_MEM_ULC_3216
    def_bool n

config __MMI_SLIM_CALCULATOR__
	option skipmk
	bool "Slim Calculator"
	default y

config DAF_DECODE
    option skipmk
    def_bool y if TARGET_MEM_ULC_3216
    def_bool n

config AUDIO_PLAYER_SUPPORT
    option skipmk
    def_bool y if TARGET_MEM_ULC_3216
    def_bool n

config __MMI_EBOOK_READER__
	option skipmk
	def_bool n if TARGET_MEM_ULC_3216
	def_bool y

config USE_SW_PNG_DECODER
	option skipmk
	def_bool n if TARGET_MEM_ULC_3216
	def_bool y

#config __MMI_SLIM_FILE_MANAGER__
#    option skipmk
#    bool "MMI_SLIM_FILE_MANAGER"
#    def_bool n if TARGET_MEM_ULC_3216
#
#config __MMI_SLIM_CALENDAR__
#    option skipmk
#    bool "MMI_SLIM_CALENDAR"
#    def_bool y if __MMI_RESOURCE_SLIM_ON_128X160__
#
#config __MMI_USING_BLACK_THEME_BG__
#    option skipmk
#    bool "__MMI_USING_BLACK_THEME_BG__"
#    default y if qqvga_3232
#    default n

config __MMI_MM_SLIM_RESOURCE__
    bool "MMI_MM_SLIM_RESOURCE"
    option skipmk
    default y
    ---help---
        MMI supports slim resource of multimedia.

config __MMI_FOLDER_DETAIL__
    option skipmk
    bool "MMI_FOLDER_DETAIL"
    default y
```

## soft/newfcfg/application/target_res/Kconfig.font
```kconfig
comment "--- Fonts and Others---"

menuconfig __MMI_LARGE_EN_FONTS__
    option skipmk
    bool "Larget English Fonts"
    default n
 
if  __MMI_LARGE_EN_FONTS__   
config __MMI_14_EN_FONT__
    option skipmk
    bool "14 English Fonts"
    default y
            
config __MMI_20_EN_FONT__
    option skipmk
    bool "20 English Fonts"
    default y
    
config __MMI_22_EN_FONT__
    option skipmk
    bool "22 English Fonts"
    default n
endif    
menuconfig __MMI_LARGE_FONTS__
    option skipmk
    bool "Larget Fonts"
    default y if !TARGET_MEM_ULC_3216
    default n
    
if __MMI_LARGE_FONTS__ 
config __MMI_20X20_CHINESE_FONT__
    option skipmk
    bool "20X20_Chinese Font"
    default y if __MMI_LANG_SM_CHINESE__
    default n
endif

config __MMI_PHB_PINYIN_SORT__
    option skipmk
    bool "PinYin Sort in PHB"
    depends on __MMI_LANG_SM_CHINESE__ && !(MEM_ULC_3216)
    default n

      
config __MMI_CHAR_SET_GB2312__
    option skipmk
    bool "Charset GB2312"
    depends on __MMI_LANG_SM_CHINESE__
    default n
    
config __MMI_CHAR_SET_BIG5__
    option skipmk
    bool "Charset BIG5"
    depends on __MMI_LANG_TR_CHINESE__
    default n     
    
config __MMI_CHSET_GB2312__
    option skipmk
    bool "__MMI_CHSET_GB2312__"
    depends on __MMI_LANG_SM_CHINESE__
    default n
    
config __MMI_CHSET_BIG5__
    option skipmk
    bool "__MMI_CHSET_BIG5__"
    depends on __MMI_LANG_TR_CHINESE__
    default n          
         
config __MMI_CHANGABLE_FONT__
    option skipmk
    bool "Change Font"
    default n     
    
config __MMI_CHSET_WESTERN_WIN__
    option skipmk
    def_bool y    
    
config __MMI_MULTITAP_KEY_0__
    option skipmk
    bool "Key0 function"
    default n
help
    change dialling screen mulitap + p w
    from key star to key-zero

config __MMI_WITH_C_KEY__
    option skipmk
    bool "Clear key function"
    default n
help
    Turn on clear key function
```

## soft/newfcfg/application/target_res/Kconfig.gb
```kconfig
menuconfig __MMI_GB__
    option skipmk
    bool "GB smart"
    default y
help 
    GB and Reverie are not compatible.
    Switch on GB then Reverie need to be switched off.
    Switch on GB to support Gb smart inputmethod.    
        
if __MMI_GB__

menuconfig __MMI_GB_V5__
    option skipmk
    bool "GB V5"
    default n
   
config __MMI_SMART_URDU__
    option skipmk
    bool "Urdu Smart"
    depends on __MMI_LANG_URDU__ && __MMI_GB_V5__
    default n 
       
config __MMI_SMART_GREEK__
    option skipmk
    bool "Greek Smart"
    depends on __MMI_LANG_GREEK__ && __MMI_GB_V5__
    default n
    
config __MMI_SMART_HEBREW__
    option skipmk
    bool "Hebrew Smart"
    depends on __MMI_LANG_HEBREW__ && __MMI_GB_V5__
    default n  

if !(__MMI_MULTITAP_BANGLA_SPEC__)     
config __MMI_SMART_BENGALI__
    option skipmk
    bool "Bengali Smart"
    depends on __MMI_LANG_BENGALI__ && __MMI_GB_V5__
    default n
endif
     
config __MMI_GB_ENGLISH__
    option skipmk
    bool "English Smart"
    depends on __MMI_LANG_ENGLISH__
    default n 
    
config __MMI_SMART_FRENCH__
    option skipmk
    bool "French Smart"
    depends on __MMI_LANG_FRENCH__ || __MMI_LANG_CA_FRENCH__
    default n 

config __MMI_SMART_ITALIAN__
    option skipmk
    bool "Italian Smart"
    depends on __MMI_LANG_ITALIAN__
    default n 
        
config __MMI_SMART_VIETNAMESE__
    option skipmk
    bool "Vietnamese Smart"
    depends on __MMI_LANG_VIETNAMESE__
    default n     
    
config __MMI_SMART_RUSSIAN__
    option skipmk
    bool "Russian Smart"
    depends on __MMI_LANG_RUSSIAN__
    default n            

config __MMI_SMART_ARABIC__
    option skipmk
    bool "Arabic Smart"
    depends on __MMI_LANG_ARABIC__ && !(MEM_ULC_3216)
    default n
    
config __MMI_SMART_THAI__
    option skipmk
    bool "Thai Smart"
    depends on __MMI_LANG_THAI__
    default n
    
config __MMI_GB_SM_CHINESE__
    option skipmk
    bool "SM Chinese"
    depends on __MMI_LANG_SM_CHINESE__
    default n
    
config __MMI_GB_TR_CHINESE__
    option skipmk
    bool "TR Chinese"
    depends on __MMI_LANG_TR_CHINESE__
    default n        
    
config __MMI_SMART_GERMAN__
    option skipmk
    bool "German Smart"
    depends on __MMI_LANG_GERMAN__
    default n     
    
config __MMI_SMART_SPANISH__
    option skipmk
    bool "Spanish Smart"
    depends on __MMI_LANG_SPANISH__ || __MMI_LANG_SA_SPANISH__
    default n    
    
config __MMI_GB_SMART_PORTUGUESE__
    option skipmk
    bool "Portuguese Smart"
    depends on __MMI_LANG_PORTUGUESE__ || __MMI_LANG_SA_PORTUGUESE__
    default n   
    
config __MMI_SMART_PERSIAN__
    option skipmk
    bool "Persian Smart"
    depends on __MMI_LANG_PERSIAN__
    default n
    
config __MMI_SMART_TURKISH__
    option skipmk
    bool "Turkish Smart"
    depends on __MMI_LANG_TURKISH__
    default n     
    
config __MMI_SMART_INDONESIAN__
    option skipmk
    bool "Indonesian Smart"
    depends on __MMI_LANG_INDONESIAN__
    default n     
    
config __MMI_SMART_MALAY__
    option skipmk
    bool "Malay Smart"
    depends on __MMI_LANG_MALAY__
    default n 
     
config __MMI_SMART_SWAHILI__
    option skipmk
    bool "Swahili Smart"
    depends on __MMI_LANG_SWAHILI__
    default n
        
config __MMI_SMART_HINDI__
    option skipmk
    bool "Hindi Smart"
    depends on __MMI_LANG_HINDI__
    default n
    
config __MMI_SMART_TELUGU__
    option skipmk
    bool "Telugu Smart"
    depends on __MMI_LANG_TELUGU__
    default n
    
config __MMI_SMART_PUNJABI__
    option skipmk
    bool "Punjabi Smart"
    depends on __MMI_LANG_PUNJABI__
    default n
           
config __MMI_SMART_TAMIL__
    option skipmk
    bool "Tamil Smart"
    depends on __MMI_LANG_TAMIL__
    default n
    
endif    
```
