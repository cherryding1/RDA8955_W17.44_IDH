## soft/newfcfg/application/target_res/Kconfig.smart
```kconfig
menuconfig __MMI_SMART_REVERIE_INPUT__
    option skipmk
    bool "Reverie Smart"
    default n
    
if __MMI_SMART_REVERIE_INPUT__

config __MMI_SMART_REVERIE_ENGLISH__
    option skipmk
    bool "English Smart"
    default n

config __MMI_SMART_REVERIE_HINDI__
    option skipmk
    bool "Hindi Smart"
    default n
    
config __MMI_SMART_REVERIE_ASSAMESE__
    option skipmk
    bool "Assamese Smart"
    default n
    
config __MMI_SMART_REVERIE_BENGALI__
    option skipmk
    bool "Bengali Smart"
    default n
        
config __MMI_SMART_REVERIE_GUJARATI__
    option skipmk
    bool "Gujarati Smart"
    default n
    
config __MMI_SMART_REVERIE_MARATHI__
    option skipmk
    bool "Marathi Smart"
    default n
    
config __MMI_SMART_REVERIE_NEPALI__
    option skipmk
    bool "Nepail Smart"
    default n                

config __MMI_SMART_REVERIE_BODO__
    option skipmk
    bool "Bodo Smart"
    default n
    
config __MMI_SMART_REVERIE_KONKANI__
    option skipmk
    bool "Konkani Smart"
    default n
   
config __MMI_SMART_REVERIE_DOGRI__
    option skipmk
    bool "Dogri Smart"
    default n
    
config __MMI_SMART_REVERIE_TELUGU__
    option skipmk
    bool "Telugu Smart"
    default n
    
config __MMI_SMART_REVERIE_TAMIL__
    option skipmk
    bool "Tamil Smart"
    default n
    
config __MMI_SMART_REVERIE_SINDHI__
    option skipmk
    bool "Sindhi Smart"
    default n
    
config __MMI_SMART_REVERIE_MALAYALAM__
    option skipmk
    bool "Malayalam Smart"
    default n
    
config __MMI_SMART_REVERIE_PUNJABI__
    option skipmk
    bool "Punjabi Smart"
    default n
    
config __MMI_SMART_REVERIE_ODIA__
    option skipmk
    bool "Odia Smart"
    default n
    
config __MMI_SMART_REVERIE_SANSKRIT__
    option skipmk
    bool "Sanskrit Smart"
    default n   
    
config __MMI_SMART_REVERIE_MANIPURI__
    option skipmk
    bool "Manipuri Smart"
    default n   
    
config __MMI_SMART_REVERIE_KANNADA__
    option skipmk
    bool "Kannada Smart"
    default n   
    
config __MMI_SMART_REVERIE_MAITHILI__
    option skipmk
    bool "Maithili Smart"
    default n   
    
config __MMI_SMART_REVERIE_SANTALI__
    option skipmk
    bool "Santali Smart"
    default n   
    
config __MMI_SMART_REVERIE_URDU__
    option skipmk
    bool "Urdu Smart"
    select __MMI_BIDI_ALG__
    default n   
    
config __MMI_SMART_REVERIE_KASHMIRI__
    option skipmk
    bool "Kashmiri Smart"
    select __MMI_BIDI_ALG__
    default n   
                                  
                                 
endif
```

## soft/newfcfg/at/Kconfig
```kconfig
config CT_MODEM
    option skiph
    int "CT_MODEM"
    range 0 2
    default 0
    ---help---
    CT_MODEM = 0 Only application
    CT_MODEM = 1 Only AT
    CT_MODEM = 2 Both application and AT

config AT_DEFAULT_UART
    int "AT Uart Number"
    range 0 3
    default 2
    ---help---
        Set Dafault UART COM PORT Number.

config AT_SECOND_UART_SUPPORT
    bool "AT_SECOND_UART_SUPPORT"
    default n

config AT_SECOND_UART
    int "AT 2nd Uart Number"
    depends on AT_SECOND_UART_SUPPORT
    range 0 3
    default 1

config AT_MODULE_SUPPORT_SLEEP
    option skipmk
    bool "AT MODULE Support Open and Close"
    default n
    ---help---
        AT module support wakeup and sleep.

config _USE_AT_OC_GPIO_
    int "AT Module Wakeup GPIO"
    range 0 31
    depends on AT_MODULE_SUPPORT_SLEEP=y
    default 2
    ---help---
        select AT module wakeup GPIO.

config AT_USB_MODEM_NO_MMMI
    option skiph
    bool
    depends on CT_MODEM=1
    default y
        ---help---
        if no mmi task, enable this micro.

config AT_ONLY_AUDIO_CALIB
    option skipmk
    bool "Support Dynamic tune Audio Parameters"
    default y if CT_MODEM=2
    default n
        ---help---
        Only When CT_MODEM=2, support Dynamic tune Audio Parameters.

config AT_WITHOUT_GPRS
    option skipmk
    bool "Support AT but not support GPRS on AT"
    depends on CT_MODEM=2
    default y if AT_ONLY_AUDIO_CALIB=y
    default n
        ---help---
        Only When CT_MODEM=2 and AT_ONLY_AUDIO_CALIB=y, this option works

config AT_WITHOUT_SMS
    option skipmk
    bool "Support AT but not support SMS on AT"
    depends on CT_MODEM=2
    default y if AT_ONLY_AUDIO_CALIB=y
    default n
        ---help---
        Only When CT_MODEM=2 and AT_ONLY_AUDIO_CALIB=y, this option works

config AT_WITHOUT_SAT
    option skipmk
    bool "Support AT but not support SAT on AT"
    depends on CT_MODEM=2
    default y if AT_ONLY_AUDIO_CALIB=y
    default n
        ---help---
        Only When CT_MODEM=2 and AT_ONLY_AUDIO_CALIB=y, this option works

config AT_WITHOUT_PBK
    option skipmk
    bool "Support AT but not support PhoneBook on AT"
    depends on CT_MODEM=2
    default y if AT_ONLY_AUDIO_CALIB=y
    default n
        ---help---
        Only When CT_MODEM=2 and AT_ONLY_AUDIO_CALIB=y, this option works

config AT_WITHOUT_SS
    option skipmk
    bool "Support AT but not support SS on AT"
    depends on CT_MODEM=2
    default y if AT_ONLY_AUDIO_CALIB=y
    default n
        ---help---
        Only When CT_MODEM=2 and AT_ONLY_AUDIO_CALIB=y, this option works

config CHIP_IS_MODEM
    option skipmk
    depends on LWIP_SUPPORT && CT_MODEM!=0
    bool "CHIP_IS_MODEM"
    default n

config AT_CMUX_SUPPORT
    bool "AT_CMUX_SUPPORT"
    default y if !AT_ONLY_AUDIO_CALIB

config AT_CAMERA_SUPPORT
    depends on CT_MODEM!=0
    bool "AT_CAMERA_SUPPORT"
    default n

config AT_SOUND_RECORDER_SUPPORT
    depends on CT_MODEM!=0
    bool "AT_SOUND_RECORDER_SUPPORT"
    default n


config AT_AUDIO_PLAY
    option skipmk
    depends on CT_MODEM!=0
    bool "AT_AUDIO_PLAY"
    default n

config MODEM_CALL_RECORDER
    option skipmk
    depends on CT_MODEM!=0
    bool "MODEM_CALL_RECORDER"
    default n
config GCF_TTS_MODEL
    option bool01
    depends on CT_MODEM!=0
    bool "GCF_TTS_MODEL"
    default n
	
config AT_NITZ_SUPPORT
    option skipmk
    depends on CT_MODEM!=0
    bool "AT_NITZ_SUPPORT"
    default n

config AT_HTTP_SUPPORT
    depends on LWIP_SUPPORT && CT_MODEM=1
    bool "AT_HTTP_SUPPORT"
    default y

config AT_FTP_SUPPORT
    option skipmk
    depends on LWIP_SUPPORT && CT_MODEM=1
    bool "AT_FTP_SUPPORT"
    default y

config AT_PING_SUPPORT
    option skipmk
    depends on LWIP_SUPPORT && CT_MODEM=1
    bool "AT_PING_SUPPORT"
    default y

config AT_NETIF_SUPPORT
    option skipmk
    depends on LWIP_SUPPORT && CT_MODEM=1
    bool "AT_NETIF_SUPPORT"
    default y

config AT_COAP_SUPPORT
    depends on LWIP_SUPPORT && CT_MODEM=1
    bool "AT_COAP_SUPPORT"
    default y

config AT_MQTT_SUPPORT
    option skipmk
    depends on LWIP_SUPPORT && CT_MODEM=1
    bool "AT_MQTT_SUPPORT"
    default y

config AT_LWM2M_SUPPORT
    depends on LWIP_SUPPORT && CT_MODEM=1
    bool "AT_LWM2M_SUPPORT"
    default y

config AT_FOTA_SUPPORT
    depends on FOTA_SUPPORT && CT_MODEM!=0
    bool "AT_FOTA_SUPPORT"
    default n

config DEFAULT_SIM_SLOT
    int "Default sim slot"
    range 0 1
    default 0
    ---help---
        Set Dafault sim slot.
```

## soft/newfcfg/custom/Kconfig
```kconfig
config CT_PROTOSTACK_IN_RAM
	option skiph
	bool "PROTOSTACK IN RAM"
	default y
	---help---
		put proto stack code to ram,enhance perfance

config EXPORT_BOARD_INFO
	option skiph
	bool "EXPORT_BOARD_INFO"
	default y
	---help---
	   Export board infomation to lod

if EXPORT_BOARD_INFO

config EXPORT_BOARD_FLAGS
	option skiph
	string "EXPORT_BOARD_FLAGS"
	default "PM_MODEL ATV_MODEL FM_MODEL"

endif

#config EFFUSE_NOT_BE_CALIBED
#	option skipmk
#	bool "EFFUSE_NOT_BE_CALIBED"
#	default y

menu "Lower Power Options"

menuconfig LOW_POWER_OPTIMISE
	option skiph
	option skipmk
	bool "Lower Power Optimise"
	default n
	---help---
	   low power optimise

if LOW_POWER_OPTIMISE
config CHIP_XTAL_CLK_IS_52M
	option skipmk
	bool "CHIP_XTAL_CLK_IS_52M"
	default y

config HAL_SHUTDOWN_PLL_IN_LIGHT_SLEEP
	option skipmk
	bool "HAL_SHUTDOWN_PLL_IN_LIGHT_SLEEP"
	default y

config HAL_FORCE_LPS_OS_ALIGN
	option skipmk
	bool "HAL_FORCE_LPS_OS_ALIGN"
	default y

config __L1_CCH_DEC_DONE_IRQ_EN__
	option skipmk
	bool "__L1_CCH_DEC_DONE_IRQ_EN__"
	default y

config XCV_WAKEUP_FRAME_NB
	option skipmk
	bool "XCV_WAKEUP_FRAME_NB"
	default y

config XCV_DAC_MUX_EN_DISABLE
	option skipmk
	bool "XCV_DAC_MUX_EN_DISABLE"
	default y

config __L1_TWO_BURST_PCH__
	option skipmk
	bool "__L1_TWO_BURST_PCH__"
	default y
	
endif	
endmenu

config GCF_TEST_SUPPORT
	option bool01
	option skipmk
	option skiph
	bool "GCF test support"
	default n

config GCF_TEST
	option skipmk
	bool "GCF_TEST"
	depends on GCF_TEST_SUPPORT
	def_bool y

config MODEM_WITHOUT_VOICE_FORGCF
	option skipmk
	bool "MODEM_WITHOUT_VOICE_FORGCF"
	depends on GCF_TEST_SUPPORT
	default n
```

## soft/newfcfg/platform/Kconfig
```kconfig
menu "boot"
source "newfcfg/platform/boot/Kconfig"
endmenu

menu "chip"
source "newfcfg/platform/chip/Kconfig"
endmenu

menu "drivers"
source "newfcfg/platform/edrv/Kconfig"
endmenu

menu "service"
source "newfcfg/platform/service/Kconfig"
endmenu

menu "system"
source "newfcfg/platform/system/Kconfig"
endmenu
```

## soft/newfcfg/platform/boot/Kconfig
```kconfig
comment "--- platform/boot ---"

config FOTA_SUPPORT
    bool "FOTA support"
    default n
```

## soft/newfcfg/platform/chip/Kconfig
```kconfig
comment "--- platform/chip ---"

choice CT_ASIC_SEL
	option skiph
	option skipmk
	prompt "ASIC Type :"
	default CT_ASIC_8809

	config CT_ASIC_8809
		option skipmk
		option skiph
		bool "8809"

	config CT_ASIC_8955
		option skipmk
		option skiph
		bool "8955"

	config CT_ASIC_8909
		option skipmk
		option skiph
		bool "8909"
endchoice

config CT_ASIC
	option skiph
	string
	default "8809" if CT_ASIC_8809
	default "8955" if CT_ASIC_8955
	default "8909" if CT_ASIC_8909

choice CT_CHIP_DIE
	option enum
	option skiph
	prompt "Chip Die :"
	default 8809e2
	---help---
		Chip die type:
		8809e2/8955/8909

	config 8809e2
		option skiph
		bool "8809e2"
	config 8955
		option skiph
		bool "8955"
	config 8909
		option skiph
		bool "8909"
	config null 
		option skiph
		bool "null"
endchoice

choice CT_COMPILER
	option enum
	option skiph
	prompt "Compiler :"
	default gcc4_xcpu

	config gcc4_xcpu
		option skiph
		bool "GCC4 XCPU"
	config gcc7_xcpu2
		option skiph
		bool "GCC7 XCPU2" if CT_ASIC_8909
endchoice

choice CT_ASIC_CFG
	option enum
	option skiph
	prompt "ASIC config"
	default chip
	---help---
	   fpga or chip?

	config fpga
		option skiph
		bool "fpga"
	config chip
		option skiph
		bool "chip"
endchoice

config SAIC_SUPPORT
	option skipmk
	option skiph
	bool "SAIC support"
	default n
	---help---
	   SAIC support

config CHIP_SAIC_SUPPORTED
	option skipmk
	depends on SAIC_SUPPORT
	bool "Chip SAIC supported"
	default y
	---help---
		Saic function is enabled.

config CHIP_SAIC_CTRL_BY_SOFT
	option skipmk
	depends on SAIC_SUPPORT
	bool "Chip SAIC Control by soft"
	default y
	---help---
		Dynamic saic is enabled，it will  be useful when CHIP_SAIC_SUPPORT is defined.

config CHIP_SAIC_ENABLE_STEP2
	option skipmk
	depends on SAIC_SUPPORT
	bool "Chip SAIC Enable Step2"
	default n
	---help---
		Full saic is enabled，it will  be useful when CHIP_SAIC_SUPPORT is defined.

config FREQ_LARGESCALE_SUPPORT
	option skipmk
	depends on CT_ASIC_8955
	bool "Support large scale Frequency"
	default y
	---help---
		This micro is patch of large freqency offset.

config DISABLE_TRACE_AT_PLL_OFF
	option skipmk
	depends on CT_ASIC_8955
	bool "Disable Trace at PLL off"
	default y

config SIM_RX_IFC_IN_SRAM
	option skipmk
	depends on CT_ASIC_8955 || CT_ASIC_8909
	bool "Put SIM RX IFC in SRAM"
	default y

config SIM_TX_IFC_IN_SRAM
	option skipmk
	depends on CT_ASIC_8955 || CT_ASIC_8909
	bool "Put SIM TX IFC in SRAM"
	default y
config LOW_TEMPERATURE_RETRY_5_TIMES
    option skipmk
    depends on CT_ASIC_8955 || CT_ASIC_8909
	bool "-40 degree low temperature losting network retry 5 times"
	default n
```

## soft/newfcfg/platform/edrv/Kconfig
```kconfig
comment "--- platform/edrv ---"

menu "ATV"
source "newfcfg/platform/edrv/atvd/Kconfig"
endmenu

menu "audio"
source "newfcfg/platform/edrv/aud/Kconfig"
endmenu

menu "bluetooth"
source "newfcfg/platform/edrv/btd/Kconfig"
endmenu

menu "usb"
source "newfcfg/platform/edrv/usb/Kconfig"
endmenu

menu "camera"
source "newfcfg/platform/edrv/camd/Kconfig"
endmenu

menu "fm"
source "newfcfg/platform/edrv/fmd/Kconfig"
endmenu

source "newfcfg/platform/edrv/gsensor/Kconfig"

menu "lcd"
source "newfcfg/platform/edrv/lcdd/Kconfig"
endmenu

menu "mem"
source "newfcfg/platform/edrv/memd/Kconfig"
endmenu

menu "pm"
source "newfcfg/platform/edrv/pmd/Kconfig"
endmenu

menu "rf"
source "newfcfg/platform/edrv/rfd/Kconfig"
endmenu

source "newfcfg/platform/edrv/wifi/Kconfig"

menu "sim"
source "newfcfg/platform/edrv/dualsimd/Kconfig"
endmenu

menu "Touch Screen"
source "newfcfg/platform/edrv/tsd/Kconfig"
endmenu

menu "gpio extend"
source "newfcfg/platform/edrv/gpioex/Kconfig"
endmenu

menu "mcd"
source "newfcfg/platform/edrv/mcd/Kconfig"
endmenu

menu "gpsd"
source "newfcfg/platform/edrv/gpsd/Kconfig"
endmenu
```

## soft/newfcfg/platform/edrv/atvd/Kconfig
```kconfig
if ANALOG_TV_SUPPORT

menu "atvd"

choice
	option skipmk
	option skiph
	prompt "ATV_MODEL"
	default atv_rda5888h
	---help---
		if use rda5888s, config to rda5888e
		
	config atv_rda5888h
		option skipmk
		option skiph
		bool	"rda5888h"
	
	config atv_rda5888he
		option skipmk
		option skiph
		bool	"rda5888he"
	
	config 	atv_rda5888e
		option skipmk
		option skiph
		bool	"rda5888e"
		
endchoice

config ATV_MODEL
	option skiph
	string
	default rda5888h if atv_rda5888h
	default rda5888he if atv_rda5888he
	default rda5888e if atv_rda5888e
	---help---
		It defines ATV model for integrated Chip.
		rda5888h/rda5888he/rda5888e
	
config ANALOG_TV_SUPPORT_MCP_LOCK
	option skipmk
	bool
	default y
	---help---
		Analog TV supports MCP lock.

config RDAATV_CHIPVER_5888E
	option skipmk
	bool
	default y if atv_rda5888e	
	default n
	---help---
		It defines the chip version of RDA5888E is 6.

config RDAATV_CHIPVER_5888HE
	option skipmk
	bool
	default y if atv_rda5888he	
	default n
	---help---
		It defines the chip version of RDA5888HE is 7.

config RDAATV_CHIPVER_5888H
	option skipmk
	bool
	default y if atv_rda5888h	
	default n
	---help---
		It defines the chip version of RDA5888H is 7.
			
choice
	option skipmk
	option skiph
	prompt "32K clock pin used by anatv:1/0"
	default atv_pin0
	---help---
		32K clock pin used by anatv:1/0,1: 32K_CLK pin,0: CLK_OUT pin
		
	config atv_pin0
		option skipmk
		option skiph
		bool	"CLK_OUT"
	
	config atv_pin1
		option skipmk
		option skiph
		bool	"32K_CLK"
		
endchoice

config TV_USE_32K_CLK_PIN
	option skiph
	string
	default 0 if atv_pin0
	default 1 if atv_pin1
	---help---
		It defines 32k clock pin of analog TV. 0 is for CLK_OUT pin; 1 is for 32K_CLK pin.

endmenu

endif
```
