## soft/newfcfg/platform/edrv/aud/Kconfig
```kconfig
comment "--- platform/edrv/aud ---"

menu "tv"
source "newfcfg/platform/edrv/aud/tv/Kconfig"
endmenu

config AD_MODEL
	option skiph
	string "AD_MODEL"
	default "codec_gallite"

config BT_BTHSNREC_SUPPORT
	option skipmk
	bool "BT BTHSNREC SUPPORT"
	depends on BT_MODEL_ENABLE
	default y
	---help---
		close all the voice enhanced module if bt voice enhanced is enabled(under bt conversation)

config RECV_USE_SPK_LINE
	option skipmk
	bool	"recv use spk line"
	default y
	---help---
		Receiver uses one speaker line (using left line by default)

config RECV_USE_SPK_LINE_R
	option skipmk
	bool	"recv use spk line r"
	default n
	---help---
		If using right line, the macro should be added as well,defalut use left line

config PM_EARPIECE_DET_DEBOUNCE
	option skipmk
	bool	"pm earpiece det debounce"
	default y
	---help---
		debounce process when earpiece pluged out or in, for wrong info when earpiece  pluged out or in

config MODULE_EAR_DETECT
	option skipmk
	bool "Module ear detect"
	default n

config MIC_CAPLESS_MODE
	option skiph
	bool	"mic capless mode"
	default y
	---help---
		if mic capless mode, set 1,otherwise 0

config MIC_MEMS_MODE
	option skipmk
	bool	"mic mems mode"
	default n
	---help---
		if mic mems mode, set 1,otherwise 0

config AUD_2_IN_1_SPK
	option skipmk
	bool	"aud 2 in 1 spk"
	default y
	---help---
		2 in 1 loudspeaker. 2 in 1 and 3 in 1 loudspeaker are mutually exclusive.

config AUD_SPK_ON_WITH_LCD
	option skipmk
	bool	"aud spk on with lcd"
	default n
	---help---
		Alleviate the "pop" sound on loud speaker for some external audio PAs

config ABB_HP_DETECT
	option skipmk
	bool	"ABB headphone detection"
	default n
	---help---
		ABB headphone detection

config VOLUME_WITH_15_LEVEL
	option skipmk
	bool "VOLUME_WITH_15_LEVEL"
	default y
	---help---
		To support 15 levels or 7 levels for volume.

config VOIS_DUMP_PCM
    option skipmk
    bool "VOIS_DUMP_PCM"
    default y
    ---help---
        This option enables vois supports dump PCM.

config CHIP_8955_AUD_WAVE_TEST
    option skipmk
	bool "CHIP_8955_AUD_WAVE_TEST"
	default n
	---help---
	    This option enables wave test on chip 8955
```

## soft/newfcfg/platform/edrv/aud/tv/Kconfig
```kconfig
comment "--- platform/edrv/aud/tv ---"

if ANALOG_TV_SUPPORT

config TV_USING_I2S
	option skiph
	bool "tv using I2S"
	default y 
	---help---
		If 5888h or 5888he then USING I2S need set 0

endif
```

## soft/newfcfg/platform/edrv/btd/Kconfig
```kconfig
comment "--- platform/edrv/btd ---"

config BT_MODEL_ENABLE
	option skiph
	option skipmk
	bool "BT Support"	
	default n if CT_ASIC_8955
	default y

if BT_MODEL_ENABLE

menu "bluetooth"

config BT_MODEL
	option skiph
	string "BT_MODEL"
	default "rdabt_8809"
	
config BT_SHARE_CRYSTAL
	option skiph
	bool "BT SHARE CRYSTAL"
	default y
	---help---
		Define BT crystal flag

choice
	option skipmk
	option skiph
	prompt "32k clock pin used by bt:1/0"
	default bt_pin0
	---help---
		32k clock pin used by bt:1/0
		
	config bt_pin0
		option skiph
		option skipmk
		bool	"CLK_OUT"
	
	config bt_pin1
		option skiph
		option skipmk
		bool	"32K_CLK"	
endchoice

config BT_USE_32K_CLK_PIN
	option skiph
	string
	default 0 if bt_pin0
	default 1 if bt_pin1
	---help---
		It defines 32k clock pin of Bluetooth. 0 is for CLK_OUT pin; 1 is for 32K_CLK pin.

endmenu

config BT_NO_A2DP_PROFILE
	option skipmk
	bool "BT NO A2DP PROFILE"
	depends on BT_MODEL_ENABLE
	default n
	---help---
		enable the config if A2DP is not supported

endif
```

## soft/newfcfg/platform/edrv/camd/Kconfig
```kconfig
comment "--- platform/edrv/camd ---"

config CAMERA_MODEL
	option skiph
	string "Camera Model"
	default "gc6133" 
	---help---
		It defines Camera model for integrated Chip.

config CAMERA_MODULE
	option skipmk
	def_bool y if CAMERA_MODEL != no
	def_bool n

config CAMERA_SUPPORT
	option skipmk
	def_bool y if CAMERA_MODEL != no
	def_bool n

config APPMEM_SUPPORT
	option skipmk
	def_bool y if CAMERA_MODEL != no
	def_bool n

config MJPG_SUPPORT 
	def_bool y if CAMERA_MODEL != no
	def_bool n

choice
	option skipmk
	option skiph
	prompt "camera module interface"
	default camera_if_spi
	---help---
		For spi interface, 8805/8806 only support pas6175/sp0828 which must config with serial LCD. 8808 serial and later without this restriction.
		For gc6113 serial camera, when emulate parallel as serial, 8805/8806 only support the way of emulating parallel as serial. 8808 serial and later without this restriction.

	config camera_if_spi
		option skiph
		option skipmk
		bool	"spi"

	config camera_if_parallel
		option skiph
		option skipmk
		bool	"parallel"
endchoice

config CAMERA_IF
	option skiph
	string
	default spi if camera_if_spi
	default parallel if camera_if_parallel
	---help---
		camera_if_spi/camera_if_parallel
	
config SUPPORT_DUAL_CAMERA
	option skipmk
	bool "SUPPORT DUAL CAMERA"
	default n
	---help---
		To support dual camera.

config MEM_3216_CAMERA_LARGE_MODE
	option skipmk
	bool "SUPPORT MEM 3216 CAMERA LARGE MODE"
	default n
	---help---
		support camera large mode(new have enough memory)
		for example,if lcd size is 160*128, open this config,
		captured photo can be 1280*1024 or 640*480

config CAMERA_SUPPORT_300K_PIXELS
	option skipmk
	bool "SUPPORT 300K pixels"
	default y

config __CAMERA_FULL_OSD__
	option skipmk
	bool "FULL OSD"
	default n
	---help---
		support full screen when capture photo or recording vedio
	
config __CAMERA_FEATURE_FLASH__
	option skipmk
	bool "CAMERA FLASH"
	default y
	---help---
		whether flash or not when take photo with camera 		

config _CAM_SMALL_MEM_
	option skipmk
	bool "CAM SMALL MEM"
	default y
	---help---
		if 8w sensor used ,enable this.
		if 30w sensor in project ULC(3216),uggest enable.
		can not enable if _CAM_SPECIAL_GC6113_ enabled
		open this feature , can support take photo smaller than
		lcd size; for example lcd size is 640*480, photos size can be
		320*240.

config _CAM_SPECIAL_GC6113_
	option skipmk
	bool
	default y if gc6133 && camera_if_parallel
	default n
	---help---
		gc6113 with define camera_if_parallel

config _CAMERA_DISPLAY_MIRRIO_
    option skipmk
    bool "CAMERA DISPLAY MIRRIO"
    default n
    ---help---
        when the module is preversion revert the display
```

## soft/newfcfg/platform/edrv/dualsimd/Kconfig
```kconfig
choice DUALSIM_MODEL
	option enum
	option skiph
	prompt "SIM MODEL"
	default rda1203_gallite_CT1129
	---help---
		It defines Dual SIM model for integrated Chip.

	config rda1203_gallite_CT1129
		option skiph
		bool	"rda1203_gallite_CT1129"
	
endchoice

config USER_SIM_SWAP
	option skipmk
	bool "USER_SIM_SWAP"
	default y if USER_SIM_ORDER != ""
	default n
	---help---
		This option enables to support the order of SIM cards dynamically when SIM init. USER_SIM_SWAP must be YES if USER_SIM_ORDER is not defined.

config USIM_SUPPORT
	option skiph
	bool "USIM"
	default y
	---help---
		this option enables to support usim card.

config NUMBER_OF_SIM
	option skiph
	int "number of sim"
	range 1 2
	default 2
	---help---
		It defines the number of SIM cards can be used.

config USER_SIM_ORDER
	option skiph
	string "order of sim"
	default "1 2"	if NUMBER_OF_SIM=2
	---help---
		It defines the order of SIM cards when support dual SIM cards.
```

## soft/newfcfg/platform/edrv/fmd/Kconfig
```kconfig
comment "--- platform/edrv/fmd ---"

config FM_MODEL
	option skiph
	string "FM Model"
	default rdafm_8809e if CT_ASIC_8809
	default rdafm_8955 if CT_ASIC_8955
	---help---
		It defines FM Model for integrated chip.

config FM_RADIO_ENABLE
	option skipmk
	bool "FM Radio Enable"
	default y
	---help---
		MMI support FM radio. It should be defined if FM_MODEL is defined.

choice
	option skipmk
	option skiph
	prompt "32k clock pin used by FM: 1/0"
	default fmpin0
	---help---
		It defines 32k clock pin of FM. 0 is for CLK_OUT pin; 1 is for 32K_CLK pin.

	config fmpin0
		option skipmk
		option skiph
		bool	"CLK_OUT"
	
	config fmpin1
		option skipmk
		option skiph
		bool	"32K_CLK"	
endchoice
		
config FM_RADIO_RECORD
	option skipmk
	bool "FM Radio Record"
	depends on FM_RADIO_ENABLE && SOUND_RECORDER_SUPPORT
	default y

config FM_RECORD_WITH_NEW_PATH
	option skipmk
	bool "FM Record With new path"
	default n

config FM_USING_I2S
	option skiph
	bool "use i2s"
	default n
	---help---
		set to 1 if I2S used, set to 0 if LINE-IN

config FM_USE_32K_CLK_PIN
	option skiph
	string
	default 0 if fmpin0
	default 1 if fmpin1
	---help---
		It defines 32k clock pin of FM. 0 is for CLK_OUT pin; 1 is for 32K_CLK pin.

config FM_LDO_WORKAROUND
	option skipmk
	bool	"FM LDO workaround"
	default n
	---help---
		To support set Dcdc when Ldo Mode.

config FM_RADIO_WITH_EXTERNAL_ANT
	option skipmk
	bool "FM_RADIO_WITH_EXTERNAL_ANT"
	default n
	---help---
		It defines whether could support FM with external antenna or not.

config FM_FLIGHT_MODE_SUPPORT
    option skipmk
    bool "Fm Flight Mode Support"
    default n
    ---help---
        Support flight mode when in FM
```

## soft/newfcfg/platform/edrv/gpioex/Kconfig
```kconfig
config GPIOI2C_MODEL
	option skiph
	bool "gpio i2c model"
    default n
	---help---
		virtual i2c with gpio

config GPIOSPI_MODEL
	option skiph
	bool "gpio spi model"
    default n
	---help---
		virtual spi with gpio
```

## soft/newfcfg/platform/edrv/gpsd/Kconfig
```kconfig
comment "--- platform/edrv/gpsd ---"



config GPSD_MODEL
	option skiph
	string "GPSD_MODEL"
	default ""
	
config GPS_DEFAULT_UART
    int "GPS_DEFAULT_UART"
    range 0 2
    default 0
	
config GPS_SUPPORT
    bool "GPS_SUPPORT"
    default n	
```

## soft/newfcfg/platform/edrv/gsensor/Kconfig
```kconfig
menuconfig GSENSOR_SUPPORT
	option skipmk
	option skiph
	bool "gsensor"
	default n
		
if GSENSOR_SUPPORT

comment "--- platform/edrv/gsensor ---"

choice
	option skipmk
	option skiph
	prompt "gsensor driver"
	default mma7660fc
	---help---
		It defines Gsensor Model for integrated Chip.
		
	config mma7660fc
		option skipmk
		option skiph
		bool	"mma7660fc"
	
	config mma7660fc_gpio
		option skipmk
		option skiph
		bool	"mma7660fc_gpio"	
endchoice
		
config GSENSOR_MODEL
	option skipmk
	string
	default mma7660fc if mma7660fc
	default mma7660fc_gpio if mma7660fc_gpio	
	---help---
		It defines Gsensor Model for integrated Chip. mma7660fc/mma7660fc_gpio							
endif
```

## soft/newfcfg/platform/edrv/lcdd/Kconfig
```kconfig
comment "--- platform/edrv/lcdd ---"
	
config LCD_MODEL
	option skiph
	string "LCD_MODEL"
	default gc9102
	   ---help---
		1 QVGA	240*320
			hx8347 lgdp4532 st7781 ssd1297 spfd5408b
			hx8367 s6d1121 st7787 ili9320
			otm3225 ili9325 ili9328 ili9340
			s6d04h0a01
		2 QCIF	176*220
			hx8340b kc20 r61503v otm2201a
			ili9225 lgb4525b r61503vr otm2201h
			ili9225b ili9225br s6d0164 dc2200
		3 QQVGA	128*160
			ili9163 s6b33bf st7669v s6d0144
			st7735 hx8345a fd54124bv
		
choice
	option skiph
	option skipmk
	prompt "lcd interface"
	default lcd_gouda
	---help---
		lcd interface:gouda/slcd
		
	config lcd_gouda
		option skiph
		option skipmk
		bool	"gouda"
			
endchoice
		
config LCD_IF
	option skiph
	string
	default gouda if lcd_gouda
	default slcd if lcd_slcd
	---help---
		guoda/slcd

config __PRJ_WITH_SPILCD__
	option skipmk
	bool
	default y if lcd_slcd
	default n
	---help---
		It must be YES if usd SPI lcd.

if lcd_gouda
config USE_SPI_LCD
	bool "use spi lcd"
	default y
	---help---
		gouda can support serial lcd starting from 8808
endif

config __USE_LCD_FMARK__
	bool "use lcd fmark"
	default n
	---help---
		use lcd fmark for fix tearing effect

config lcd_line_8_low
	option skipmk
	bool "lcd line 8 low"
	default y
	---help---
		former platform support low 8 and high 8 for lcd wire connection. now 8 lod is common used.
	
menuconfig SUBLCD_MODEL_ENABLE
	option skiph
	option skipmk
	bool "sub lcd"
	default n
	
if SUBLCD_MODEL_ENABLE

choice
	option skiph
	option skipmk
	prompt "sub lcd interface"
	default sub_lcd_gouda
	---help---
		lcd interface:gouda/slcd
		
	config sub_lcd_gouda
	bool	"gouda"
	
	config sub_lcd_slcd
	bool	"slcd"
		
endchoice
		
config SUBLCD_IF
	option skiph
	string
	default gouda if sub_lcd_gouda
	default slcd if sub_lcd_slcd
	
	
if sub_lcd_gouda

config USE_SPI_SUBLCD
	option skipmk
	bool "use spi lcd"
	default n	
endif
	
choice
	option skiph
	prompt "sub lcd size"
	default SUBLCDSIZE_128_128
	---help---
		SUBLCDSIZE_128_128/SUBLCDSIZE_96_64/SUBLCDSIZE_64_96
		
	config SUBLCDSIZE_128_128
		option skipmk
		bool	"SUBLCDSIZE_128_128"
	
	config SUBLCDSIZE_96_64
		option skipmk
		bool	"SUBLCDSIZE_96_64"
	
	config SUBLCDSIZE_64_96
		option skipmk
		bool	"SUBLCDSIZE_64_96"
		
endchoice	

config DUAL_LCD
	option skipmk
	bool
	default y
	 	
endif

config LCD_BACKLIGHT_CHARGE_PUMP
	option skiph
	bool "LCD backlight charge pump"
	default n
	---help---
		whether to enable charge pump for lcd backlight.
```

## soft/newfcfg/platform/edrv/mcd/Kconfig
```kconfig
config MCD_IF
	option skiph
	string "MCD IF"
	default sdmmc
	---help---
		Interface: sdmmc/spi
```
