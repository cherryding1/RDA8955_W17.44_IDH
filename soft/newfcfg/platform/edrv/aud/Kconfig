## soft/newfcfg/platform/edrv/tsd/Kconfig
```kconfig
config TSD_MODEL
	option skiph
	string "TSD_MODEL"
	default ""
	---help---
		It defines TSD Model for integrated Chip.
```

## soft/newfcfg/platform/edrv/usb/Kconfig
```kconfig
config UCTLS_SERVICE
    option skiph
    bool "UCTLS_SERVICE"
    default y

config _UTRACE_
    depends on UCTLS_SERVICE
    bool "usb trace"
    default y

config _UMSS_
    depends on UCTLS_SERVICE
    bool "usb mass storage"
    default y

config _UCDCACM_
    depends on UCTLS_SERVICE
    bool "usb cdcacm"
    default y

config _UVIDEO_
    depends on UCTLS_SERVICE
    bool "usb video"
    default n

config _URNDIS_
    depends on UCTLS_SERVICE
    bool "usb rndis"
    default n

if _UMSS_
config _UMSS_DUAL_MC_
    option skiph
    bool
    default n
endif

if _UCDCACM_
config __MMI_USB_COM_PORT__
    option skipmk
    bool
    default y

config AT_USE_USB_TRAS_DATA
    option skipmk
    bool "AT_USE_USB_TRAS_DATA"
    default y

config _TO_ADAPT_SPRD_COM_PC_DRIVER_
    option skipmk
    bool "TO_ADAPT_SPRD_COM_PC_DRIVER"
    default y
    ---help---
        This option enables usb supports com port of spredum.
endif

if _UVIDEO_
config WEBCAM_SUPPORT
    option skipmk
    bool
    default y
endif

if _URNDIS_
config __USB_TETHERING__
    option skipmk
    bool
    default y
endif
```

## soft/newfcfg/platform/edrv/wifi/Kconfig
```kconfig
menuconfig WIFI_SUPPORT
	option skipmk
	bool "wifi"
	default n
	
if 	WIFI_SUPPORT

choice
	option skiph
	option skipmk
	prompt "32k clock pin used by wifi: 1/0"
	default wifipin0
		
	config wifipin0
		option skiph
		option skipmk
		bool	"CLK_OUT"
	
	config wifipin1
		option skiph
		option skipmk
		bool	"32K_CLK"	
endchoice
		
config WIFI_USE_32K_CLK_PIN
	option skiph
	string
	default 0 if wifipin0
	default 1 if wifipin1

config WIFI_MODEL
	option skiph
	string "WIFI_MODEL"
	default "rdawifi"

config WIFI_CHIP
	option skiph
	string "WIFI_CHIP"
	default "5991h"

config __SCAN_INFO__
	option skipmk
	bool "__SCAN_INFO__"
	default y
	---help---
	   __SCAN_INFO__

config __USE_GPIO__
	option skipmk
	bool "__USE_GPIO__"
	default y
	---help---
	   __USE_GPIO__

config USE_SDIO_DMA
	option skipmk
	bool "USE_SDIO_DMA"
	default y
	---help---
	   USE_SDIO_DMA

config __USE_SDMMC1__
	option skipmk
	bool "__USE_SDMMC1__"
	default y
	---help---
	   __USE_SDMMC1__

config WIFI_SMARTCONFIG
	option skipmk
	bool "WIFI_SMARTCONFIG"
	default n
	---help---
	   WIFI_SMARTCONFIG

config WIFI_SNIFFER
	option skipmk
	bool "WIFI_SNIFFER"
	default n
	---help---
	   WIFI_SNIFFER
endif
```

## soft/newfcfg/platform/service/Kconfig
```kconfig
comment "--- platform/service ---"

menu "base"
source "newfcfg/platform/service/base/Kconfig"
endmenu

menu "gprs"
source "newfcfg/platform/service/gprs/Kconfig"
endmenu

menu "Net Support"
	depends on GPRS_SUPPORT || WIFI_SUPPORT
	source "newfcfg/platform/service/net/Kconfig"
endmenu

config CALL_AMR_SUPPORT
    bool "CALL_AMR_SUPPORT"
    option skiph
    default y
    ---help---
        This option enables AMR support when speech call.
```

## soft/newfcfg/platform/service/base/Kconfig
```kconfig
comment "--- platform/service/base ---"

config _FS_DEBUG
	option skipmk
	bool "File System Debug"
	default n
	---help---
	   Open the File System debug.

config CSW_COS_USING_ONE_HEAP
	option skipmk
	bool "CSW Use the same Heap with COS"
	default n
	---help---
	    This option enables CSW can use the same heap with COS.

config CFG_NEW_MECHANISM_TEST
	bool "load/store config with new mechanism test"
	default n

comment "--- VDS Cache Related Options ---"
config VDS_CACHE_USER_CLUSTER
	option skipmk
	bool "VDS cache buffer from COS heap"
	default y
	---help---
	    This option enables VDS supports get cache buffer from COS heap.

config __VDS_QUICK_FLUSH__
	option skipmk
	bool "VDS Quick Flush"
	default y
	---help---
	    This option enables VDS supports save user data quickly.

config USER_DATA_CACHE_SUPPORT
	option skipmk
	bool "user data support using cache"
	default y
	---help---
	    This option enables data structure of flash cache has redundent data regions.

config __MMI_NEW_NVRAM_INTERFACE__
    option skipmk
    bool "MMI_NEW_NVRAM_INTERFACE"
    default y
    ---help---
        This option enables MMI user new nvram with related API.

config REDUNDANT_DATA_REGION
	bool "Flash cache support redundent data regions"
	default n

config FS_SUPPORT_EXFAT
	option skipmk
	bool "File System support exfat"
	default n
    ---help---
        This option enables that file system can support exfat type.

config __RESTORE_RESET_NORMAL_POWERON_MODE__
    option skipmk
    bool "RESTORE_RESET_NORMAL_POWERON_MODE"
    default y
    ---help---
    	To set normal poweron mode after restore factory mode.
```

## soft/newfcfg/platform/service/gprs/Kconfig
```kconfig
config EGPRS_SUPPORT
	option skiph
	bool "EGPRS_SUPPORT"
	default n

config GPRS_SUPPORT
	option skiph
	default y
	bool "GPRS_SUPPORT"
		
if GPRS_SUPPORT

config __AUTO_GPRS_ATT__
	option skipmk
	bool "AUTO GPRS ATT"
	default n
	---help---
		gprs automatic attach at poweron or switch on

config __MOD_TCM__
	option skipmk
	bool "__MOD_TCM__"
	default y

config __GPRS_MODE__
	option skipmk
	bool "__GPRS_MOD__"
	default y

config __TCPIP__
	option skipmk
	bool "__TCPIP__"
	default y

config __GPRS_SWITCH__
	option skipmk
	bool "__GPRS_SWITCH__"
	default y

config CFW_GPRS_SUPPORT
	option skipmk
	bool "CFW_GPRS_SUPPORT"
	default y

endif
```

## soft/newfcfg/platform/service/net/Kconfig
```kconfig
comment "--- platform/service/net/ ---"

config CFW_TCPIP_SUPPORT
	bool "CFW_TCPIP_SUPPORT"
	default y

config CFW_PPP_SUPPORT
	bool "CFW_PPP_SUPPORT"
	def_bool n if CT_MODEM=0
	default y

menuconfig LWIP_SUPPORT
	depends on CFW_TCPIP_SUPPORT
	bool "Lwip Support"
	default y

if LWIP_SUPPORT
	config LWIP_DEBUG_ON
		bool "LWIP_DEBUG_ON"
		default y

	config LWIP_PPP_ON
	    depends on CFW_PPP_SUPPORT
		bool "LWIP_PPP_ON"
		default y

	config LWIP_IPV4_ON
		bool "LWIP_IPV4_ON"
		default y

	config LWIP_IPV6_ON
		bool "LWIP_IPV6_ON"
		def_bool n if CT_MODEM=0
		def_bool y

	config LWIP_TEST
		bool "LWIP_TEST"
		def_bool n if CT_MODEM=0
		def_bool y

if LWIP_TEST
	config LWIP_MQTT_TEST
		bool "LWIP_MQTT_TEST"
		default y if CT_MODEM=1
		default n

	config LWIP_HTTP_TEST
		bool "LWIP_HTTP_TEST"
		default y if CT_MODEM=1
		default n

	config LWIP_COAP_TEST
		bool "LWIP_COAP_TEST"
		default y if CT_MODEM=1
		default n

    config LWIP_LIBWM2M_TEST
        bool "LWIP_LIBWM2M_TEST"
        default y if CT_MODEM=1
        default n
endif

endif
```

## soft/newfcfg/platform/system/Kconfig
```kconfig
comment "--- platform/system ---"

menu "calib"
source "newfcfg/platform/system/calib/Kconfig"
endmenu

menu "mdi"
source "newfcfg/platform/system/mdi/Kconfig"
endmenu
```

## soft/newfcfg/platform/system/calib/Kconfig
```kconfig
comment "--- platform/system/calib ---"

config CES_DISPLAY
	option skiph
	bool "Screen display in RF calibration"
	default n
	---help---
		Screen display in RF calibration: 1/0
		if not configured here,CES_DISPLAY will set to 1 by ${PLATFORM_SYSTEM}/calib
		for ULC project, CES_DISPLAY can set to 0 to save flash space.

config CALIB_USE_0207
	bool "CALIB_USE_0207"
	option skipmk
	default y if CT_ASIC_8809
	default n if CT_ASIC_8955
	default n if CT_ASIC_8909
```

## soft/newfcfg/platform/system/mdi/Kconfig
```kconfig
comment "--- platform/system/mdi ---"

config MEDIA_RM_SUPPORT
	bool "MEDIA_RM_SUPPORT"
	default n
	---help---
	    This option enables rm format support. The feature need enough memeory size.

config VIDEO_PLAYER_SUPPORT
	bool "VIDEO_PLAYER_SUPPORT"
	default y
	---help---
	    This option enables video player support.

config SOUND_RECORDER_SUPPORT
	bool "SOUND_RECORDER_SUPPORT" 
	default y
	---help---
	    This option enables sound recorder support.

config VIDEO_RECORDER_SUPPORT
	bool "VIDEO_RECORDER_SUPPORT"
	default y
	---help---
	    This option enables video recorder support.

config VDOREC_MODE_VGA
	option skipmk
	bool "VGA(640X480) recording"
	depends on VIDEO_PLAYER_SUPPORT
	default n
	---help---
	    This option enables video recorder supports VGA mode.

config MEDIA_MIDI_SUPPORT
	bool "MEDIA_MIDI_SUPPORT"
	default n
	---help---
	    This option enables midi format.

config DONOT_SUPPORT_DUAL_BUFFER
	option skipmk
	bool "DONOT_SUPPORT_DUAL_BUFFER"
	default n
	---help---
	    This option disables that video recorder does NOT support dual buffer. If set at NO, VID_REC_CAP_DUAL_BUF will work.
```
