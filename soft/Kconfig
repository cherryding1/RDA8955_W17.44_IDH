## soft/newfcfg/application/coolmmi/mmi/bluetooth/Kconfig
```kconfig
comment "--- application/coolmmi/mmi/bluetooth ---"

if BT_MODEL_ENABLE

config MMI_SUPPORT_BLUETOOTH
	option skiph
	bool "BT Support"
	default y
	---help---
		For general Bluetooth MMI screen in any related application.

config __MMI_SUPPORT_BLUETOOTH__
	option skipmk
	bool
	def_bool y if MMI_SUPPORT_BLUETOOTH

config __BTCOOLSAND__
	option skipmk
	bool "BT coolsand support"
	depends on __MMI_SUPPORT_BLUETOOTH__
	default y
	---help---
		It must be defined if defines MMI_SUPPORT_BLUETOOTH.

config __BT_HFG_PROFILE__
	option skipmk
	bool "BT support HFG profile"
	depends on __MMI_SUPPORT_BLUETOOTH__
	default y

config __BT_DUN_PROFILE__
	option skipmk
	bool "BT support DUN profile"
	depends on __MMI_SUPPORT_BLUETOOTH__
	default n

config __BT_SPP_PROFILE__
	option skipmk
	bool "BT support SPP profile"
	depends on __MMI_SUPPORT_BLUETOOTH__
	default n

config __BT_OPP_PROFILE__
	option skipmk
	bool "BT support OPP profile"
	depends on __MMI_SUPPORT_BLUETOOTH__
	default y

config __BT_FTS_PROFILE__
	option skipmk
	bool "BT support FTS profile"
	depends on __MMI_SUPPORT_BLUETOOTH__
	default y

config __BT_FTC_PROFILE__
	option skipmk
	bool "BT support FTC profile"
	depends on __MMI_SUPPORT_BLUETOOTH__
	default n

config __BT_FTS_PROFILE_SMALL__
	option skipmk
	bool "BT support small FTC profile"
	depends on __MMI_SUPPORT_BLUETOOTH__
	default n	

config __MMI_BTTEST__
	option skipmk
	bool "BT MMI test"
	depends on __MMI_SUPPORT_BLUETOOTH__
	default y
	---help---
		MMI supports bt test in engineer mode. It must be defined if defines MMI_SUPPORT_BLUETOOTH.

config __BT_NO_A2DP_PROFILE__
    option skipmk
    bool "BT NOT support A2DP profile"
    default n
    ---help---
    	Bluetooth does Not support A2DP profile.

 config __BT_A2DP_PROFILE__
 	option skipmk
 	bool "BT support A2DP profile"
 	depends on !__BT_NO_A2DP_PROFILE__
 	def_bool y

 config __BT_AVRCP_PROFILE__
 	option skipmk
 	bool "BT support AVRCP profile"
 	depends on !__BT_NO_A2DP_PROFILE__
 	def_bool y

config __MMI_BT_SUPPORT__
	option skipmk
	bool "BT MMI screen, menu, string, image"
	depends on __BTCOOLSAND__
	def_bool y

config __MMI_BT_COOLSAND_SUPPORT__
	option skipmk
	bool "BT MMI for bchs"
	depends on __BTCOOLSAND__
	def_bool y

config __MMI_EM_BT_RF_TEST__
	option skipmk
	bool "BT RF test"
	depends on __BTCOOLSAND__
	def_bool y

config __MMI_EM_BT_GET_CHIP_VERION__
	option skipmk
	bool "BT Get Chip Version"
	depends on __BTCOOLSAND__
	def_bool y

config __BT_RDA5868__
	option skipmk
	bool "RDA BT test"
	depends on __BTCOOLSAND__
	def_bool y

config __MMI_HFP_SUPPORT__
	option skipmk
	bool "BT MMI For HFG"
	def_bool y if __MMI_BT_SUPPORT__ && __BT_HFG_PROFILE__
	def_bool n

config __MMI_SPP_SUPPORT__
	option skipmk
	bool "BT MMI For SPP"
	def_bool y if __MMI_BT_SUPPORT__ && __BT_SPP_PROFILE__
	def_bool n

config __MMI_DUN_SUPPORT__
	option skipmk
	bool "BT MMI For DUN"
	def_bool y if __MMI_BT_SUPPORT__ && __BT_DUN_PROFILE__
	def_bool n

config __MMI_OPP_SUPPORT__
	option skipmk
	bool "BT MMI For OPP"
	def_bool y if __MMI_BT_SUPPORT__ && __BT_OPP_PROFILE__
	def_bool n

config __MMI_FTS_SUPPORT__
	option skipmk
	bool "BT MMI For FTS"
	def_bool y if __MMI_BT_SUPPORT__ && __BT_FTS_PROFILE__
	def_bool n

config __MMI_FTC_SUPPORT__
	option skipmk
	bool "BT MMI For FTC"
	def_bool y if __MMI_BT_SUPPORT__ && __BT_FTC_PROFILE__
	def_bool n

config __MMI_FTC_MULTIPULL_SUPPORT__
	option skipmk
	bool "BT MMI For FTC Multipull"
	def_bool y if __MMI_BT_SUPPORT__ && __BT_FTC_PROFILE__
	def_bool n

config __MMI_A2DP_SUPPORT__
	option skipmk
	bool "BT MMI For A2DP"
	def_bool y if __MMI_BT_SUPPORT__ && __BT_A2DP_PROFILE__
	def_bool n

config __MMI_AVRCP_SUPPORT__
	option skipmk
	bool "BT MMI For AVRCP"
	def_bool y if __MMI_BT_SUPPORT__ && __BT_AVRCP_PROFILE__
	def_bool n

config __MMI_SIMAP_SUPPORT__
	option skipmk
	bool "BT MMI For SIMAP"
	def_bool y if __MMI_BT_SUPPORT__ && __BT_SIM_PROFILE__
	def_bool n

config __MMI_FAX_SUPPORT__
	option skipmk
	bool "BT MMI For FAX"
	def_bool y if __MMI_BT_SUPPORT__ && __BT_FAX_PROFILE__
	def_bool n

config __MMI_HIDD_SUPPORT__
	option skipmk
	bool "BT MMI For HID device"
	def_bool y if __MMI_BT_SUPPORT__ && __BT_HIDD_PROFILE__
	def_bool n

config __MMI_BT_PROHIBIT_OPP__
	option skipmk
	bool "BT OPP services was prohibitted while a2dp is active"
	def_bool y if __MMI_A2DP_SUPPORT__ && __MMI_BT_BCHS_SUPPORT__
	def_bool n

config __MMI_BT_PROHIBIT_FTP__
	option skipmk
	bool "BT FTP services was prohibitted while a2dp is active"
	def_bool y if __MMI_A2DP_SUPPORT__ && __MMI_BT_BCHS_SUPPORT__
	def_bool n

config __MMI_BT_PROHIBIT_SPP__
	option skipmk
	bool "BT SPP services was prohibitted while a2dp is active"
	def_bool y if __MMI_A2DP_SUPPORT__ && __MMI_BT_BCHS_SUPPORT__
	def_bool n

config __MMI_BT_PROHIBIT_DUN__
	option skipmk
	bool "BT DUN services was prohibitted while a2dp is active"
	def_bool y if __MMI_A2DP_SUPPORT__ && __MMI_BT_BCHS_SUPPORT__
	def_bool n

config __MMI_BT_SIMPLE_PAIR__
	option skipmk
	bool "MMI BT SIMPLE PAIR"
	depends on BT_MODEL_ENABLE
	default y
	---help---
		MMI supports bluetooth pairing.

config BT_A2DP_ANA_DAC_MUTE
    bool "BT_A2DP_ANA_DAC_MUTE"
    default y
    ---help---
    	To support mute ANA gain and DAC gain when playing music via bluetooth.If it defines to 0, current will increase when playing music via bluetooth.

endif
```

## soft/newfcfg/application/coolmmi/mmi/callmanagement/Kconfig
```kconfig
comment "--- application/coolmmi/mmi/callmanagement ---"

config __MMI_CALLING_CALLHISTORY_SUPPORT__
    option skipmk
    bool "MMI_CALLING_CALLHISTORY_SUPPORT"
    default y
    ---help---
    	To support to enter call history when calling.
```

## soft/newfcfg/application/coolmmi/mmi/calls/Kconfig
```kconfig
comment "--- application/coolmmi/mmi/calls ---"

#config __IP_NUMBER__
#    option skipmk
#    bool "IP_NUMBER"
#    default n
#
config __MMI_CALL_RECORDER__
    option skipmk
    bool "MMI_CALL_RECORDER"
    default y
    ---help---
        MMI supports call recording function. It must define __MMI_AUTO_CALL_RECORDER__ / __MMI_CALL_RECORDER_FILE_SAVE_PATH__ at the same time.

config __MMI_AUTO_CALL_RECORDER__
    option skipmk
    bool "MMI_AUTO_CALL_RECORDER"
    default y
    ---help---
        To support call recording function.

config __MMI_CALL_RECORDER_FILE_SAVE_PATH__
    option skipmk
    bool "MMI_CALL_RECORDER_FILE_SAVE_PATH"
    default y
    ---help---
        To support call recording function.

config  __MMI_SELF_SOS__
    option skipmk
    bool "MMI_SELF_SOS"
    default n
    ---help---
        MMI supports SOS function.

config INCOMING_CALL_RINGTONE_AUD_MODE_LOUDSPK_HEADSET
    option skipmk
    bool "INCOMING_CALL_RINGTONE_AUD_MODE_LOUDSPK_HEADSET"
    default y
    ---help---
        Loudspeaker and headset both can ring when incoming call.
```

## soft/newfcfg/application/coolmmi/mmi/idlescreen/Kconfig
```kconfig
comment "--- application/coolmmi/mmi/idlescreen ---"

config __MMI_DEDICATED_KEY_SHORTCUTS__
    option skipmk
    bool "MMI_DEDICATED_KEY_SHORTCUTS"
    default y
    ---help---
    	To support dedicated key for shortcut in some screens like idle.

config SHORTCUTS_APP
    option skipmk
    bool "SHORTCUTS_APP"
    default y
    ---help---
    	MMI supports shortcut setting function and display shortcut list in IDLE screen..

config __MMI_SMARTPHONE_FEATHER__
	option skipmk
	bool "MMI SmartPhone Feathers"
	default n
	---help---
	   MMI SmartPhone Feathers

config __IPHONE__
	option skipmk
	bool "Iphone Like Style"
	default y if __MMI_SMARTPHONE_FEATHER__
	default n

config __MMI_IPHONE_EXTRA__
	option skipmk
	bool "Iphone Extra"
	default y if __IPHONE__
	default n

config __MMI_IPHONE_VKB__
	option skipmk
	bool "Iphone Virtual Keyboard"
	default y if __IPHONE__
	default n

config __MMI_CHANGE_WIN_WITH_DYNAMIC__
	option skipmk
	bool "change win with dynamic memory"
	default y if __IPHONE__
	default n

config __MMI_LIKE_IPHONE_FEATURE__
	option skipmk
	bool "IDLE Like Iphone Features"
	default y if __IPHONE__
	default n
```

## soft/newfcfg/application/coolmmi/mmi/messages/Kconfig
```kconfig
comment "--- application/coolmmi/mmi/messages ---"

config PHONE_SMS_ENTRY_COUNT
    int "PHONE_SMS_ENTRY_COUNT"
    range 0 100
    default 100
    ---help---
        Select the maximum count for SMS saved in phone. By default, set at 100.

config SIM_SMS_ENTRY_COUNT
    int "SIM_SMS_ENTRY_COUNT"
    range 0 255
    default 255
    ---help---
        Select the maximum count for SMS saved in SIM. By default, set at 255.

config __MMI_MESSAGES_DRAFT_BOX__
    option skipmk
    bool "MMI_MESSAGES_DRAFT_BOX"
    default y

config __MMI_MESSAGES_DELETE_SAME_NUMER__
    option skipmk
    bool "MMI_MESSAGES_DELETE_SAME_NUMER"
    default y

config __MMI_MESSAGES_SMS_MARK_SEVERAL__
    option skipmk
    bool "MMI_MESSAGES_SMS_MARK_SEVERAL"
    default y

config __MMI_MESSAGES_DRAFT_BOX_SPLIT__
    option skipmk
    bool "MMI_MESSAGES_DRAFT_BOX_SPLIT"
    default y

config __MMI_MESSAGES_COPY__
    option skipmk
    bool "MMI_MESSAGES_COPY"
    default y

config SUPPORT_SMS_EXPORT_IMPORT
    option skipmk
    bool "SUPPORT_SMS_EXPORT_IMPORT"
    default y

config __MMI_MSG_NUM_ADD_TO_BLACKLIST__
    option skipmk
    bool "MMI_MSG_NUM_ADD_TO_BLACKLIST"
    default y

config __MMI_MESSAGES_RENAME_OUTBOX__
    option skipmk
    bool "MMI_MESSAGES_RENAME_OUTBOX"
    default y

config __MMI_MESSAGES_VOICE_MAIL__
    option skipmk
    bool "MMI_MESSAGES_VOICE_MAIL"
    default y

#config __MMI_MSG_NUM_ADD_TO_BLACKLIST__
#    option skipmk
#    bool "MMI_MSG_NUM_ADD_TO_BLACKLIST"
#    default y

config __MMI_MESSAGES_MULTI_REPLY__
    option skipmk
    bool "MMI_MESSAGES_MULTI_REPLY"
    default y

config __MMI_MESSAGES_BLACK_LIST__
    option skipmk
    bool "Message Black List"
    default y

config CM_SMS_MAX_MSG_NUM
	option skiph
	int "CM_SMS_MAX_MSG_NUM"
	range 0 100
	default PHONE_SMS_ENTRY_COUNT
	---help---
	   it was used in simulator and saved temporarily.

config MAX_INDEX_MAP_LENGTH
	option skiph
	int "MAX_INDEX_MAP_LENGTH"
	range 0 100
	default PHONE_SMS_ENTRY_COUNT
	---help---
	   it was used in simulator and saved temporarily.

config CB_SUPPORT
	bool "Cell Broadcast"
	default y
	---help---
		cell broadcast support

config __MMI_MESSAGES_CB__
	option skipmk
	def_bool y if __MOD_SMSAL__ && CB_SUPPORT
	def_bool n

config __MMI_MESSAGES_CB_MSG_STORED_LIST__
	option skipmk
	def_bool y if __MOD_SMSAL__ && __MMI_MESSAGES_CB__
	def_bool n

config __MMI_MESSAGES_CB_CHNL_WITH_NAME__
	option skipmk
	def_bool y if __MOD_SMSAL__ && __MMI_MESSAGES_CB__
	def_bool n

config __MMI_MESSAGES_TWO_CB_MODES_DISPLAY__ 
	option skipmk
	def_bool y if __MOD_SMSAL__ && __MMI_MESSAGES_CB__
	def_bool n

#config MESSAGES_CB_DEBUG
#	option skipmk
#	bool "MESSAGES CB DEBUG"
#	default n
```

## soft/newfcfg/application/coolmmi/mmi/organizer/Kconfig
```kconfig
comment "--- application/coolmmi/mmi/organizer ---"

config __MMI_GAME__
	option skipmk
	bool "GAME_SUPPORT"
	default y
    ---help---
        This option enables to support Game.

config CALENDAR_SUPPORT
    option skipmk
    bool "CALENDAR_SUPPORT"
    default y
    ---help---
    CALENDAR_SUPPORT depends on the resouce type defined by CT_ERES.

config TODOLIST_SUPPORT
    option skipmk
    bool "TODOLIST_SUPPORT"
    default y
    ---help---
    TODOLIST_SUPPORT depends on the resouce type defined by CT_ERES.
	
config ORGANIZER_SUPPORT
    option skipmk
    bool "ORGANIZER_SUPPORT"
    default y
    ---help---
    ORGANIZER_SUPPORT depends on the resouce type defined by CT_ERES.

config __MOD_FLASHLIGHT__
    option skipmk
    bool "TORCH_LED_SUPPORT"
    default y
    ---help---
        This option enables to support Torch LED.

config __MMI_WORLD_CLOCK__
    option skipmk
    bool "WORLD_CLOCK_SUPPORT"
    default y
    ---help---
        This option defines whether supports world clock function.

config WORLD_CITY_LIST_NUMBER
	option skiph
	option skipmk
	int "World Clock City List"
	depends on __MMI_WORLD_CLOCK__
	range 1 4
	default 3
    ---help---
        It defines the list number of world clock to enable below Macro.
        __MMI_WCLOCK_CITY_LIST_1__
        __MMI_WCLOCK_CITY_LIST_2__
        __MMI_WCLOCK_CITY_LIST_3__
        __MMI_WCLOCK_CITY_LIST_4__

config __MMI_WCLOCK_CITY_LIST_1__
    option skipmk
    def_bool y if WORLD_CITY_LIST_NUMBER = 1
	default n

config __MMI_WCLOCK_CITY_LIST_2__
    option skipmk
    def_bool y if WORLD_CITY_LIST_NUMBER = 2
	default n

config __MMI_WCLOCK_CITY_LIST_3__
    option skipmk
    def_bool y if WORLD_CITY_LIST_NUMBER = 3
	default n

config __MMI_WCLOCK_CITY_LIST_4__
    option skipmk
    def_bool y if WORLD_CITY_LIST_NUMBER = 4
	default n
```
