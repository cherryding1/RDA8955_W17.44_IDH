## soft/Kconfig
```kconfig
comment "--- RDA Software Configuration ---"

menu "Platform"
source "newfcfg/platform/Kconfig"
endmenu

menu "Custom Setup"
source "newfcfg/custom/Kconfig"
endmenu

menu "Application"
source "newfcfg/application/Kconfig"
endmenu

menu "AT"
source "newfcfg/at/Kconfig"
endmenu

menu "Debug"
source "newfcfg/Kconfig.debug"
endmenu

menu "Default"
source "newfcfg/Kconfig.default"
endmenu
```

## soft/newfcfg/Kconfig.debug
```kconfig
comment "--- Debug Options ---"

config WITHOUT_WERROR
	option skiph
	bool "WITHOUT_WERROR"
	default y
	---help---
	   Compile warning regard as error
	   
config JOB_DEBUG
    option skipmk
    bool "JOB_DEBUG"
    default n
    ---help---
    	To open page spy for job debug.

comment "--- Register Debug Options ---"

config SPI_REG_DEBUG
	option skiph
	bool "SPI register Debug"
	default y
	---help---
	   Open the SPI register debug

config I2C_REG_DEBUG
	option skiph
	bool "I2C register Debug"
	default n
	---help---
	   Open the I2C register debug, used for debug FM

comment "--- Profile Options ---"

choice
	prompt "Profile"
	default HAL_PROFILE_ON_BUFFER
	---help---
	   Open the Hal Profile

	config HAL_PROFILE_ON_BUFFER
		option skipmk
		bool "On Buffer"
	config HAL_PROFILE_ON_ROMULATOR
		option skipmk
		bool "On Romulator"
	config DISABLE
		option skipmk
		option skiph
		bool "Disable"

endchoice

if HAL_PROFILE_ON_ROMULATOR || HAL_PROFILE_ON_BUFFER

config HAL_PROFILING
	option skipmk
	bool "HAL Profile"
	default y
	---help---
	   Hal Profile Enable or Disable

config SX_PROFILING
	option skipmk
	bool "SX Profile"
	default y 
	---help---
	   SX Profile Enable or Disable

config PAL_PROFILING
	option skipmk
	bool "PAL Profile"
	default y 
	---help---
	   PAL Profile Enable or Disable

config VOIS_PROFILING
	option skipmk
	bool "VOIS Profile"
	default y 
	---help---
	   VOIS Profile Enable or Disable

config STK_PROFILING
	option skipmk
	bool "STK Profile"
	default n 
	---help---
	   STK Profile Enable or Disable

config PMD_PROFILING
	option skipmk
	bool "PMD Profile"
	default n 
	---help---
	   PMD Profile Enable or Disable

config TSD_PROFILING
	option skipmk
	bool "TSD Profile"
	default n 
	---help---
	   TSD Profile Enable or Disable

config DUALSIMD_PROFILING
	option skipmk
	bool "Dual Sim Profile"
	default n 
	---help---
	   SX Profile Enable or Disable

endif

comment "--- Trace Options ---"

config EARLY_TRACE_OPEN
	option skipmk
	bool "Early Open Trace"
	default n
	---help---
	   Open the trace when the system start up.

config SXS_NO_DUMP
	option skipmk
	bool "SXS No Dump"
	default n
	---help---
	   System dump.

config SXS_NO_PRINTF
	option skipmk
	bool "SXS No Trace"
	default n
	---help---
	   Trace for SXS.

config AT_NO_TRACE
	option skipmk
	bool "AT No Trace"
	default y
	---help---
	   Trace for AT.

config MMI_NO_TRACE
        option skipmk
	bool "MMI No Trace"
	default y
	---help---
	   Trace for MMI.

config WAP_NO_TRACE
	bool "WAP No Trace"
	default y
	---help---
	   Trace for WAP.
	   
config CSW_NO_TRACE
	option skipmk
	bool "CSW No Trace"
	default y
	---help---
	   Trace for CSW.

config MCI_NO_TRACE
	option skipmk
	bool "MCI No Trace"
	default y
	---help---
	   Trace for MCI.

config STACK_NO_PRINTF
	bool "Stack No Trace"
	default y
	---help---
	   Trace for Stack.

config HAL_NO_PRINTF
	option skipmk
	bool "HAL No Trace"
	default y
	---help---
	   Trace for HAL.

config PAL_NO_TRACE
	option skipmk
	bool "PAL No Trace"
	default y
	---help---
	   Trace for PAL.

config VOIS_NO_PRINTF
	option skipmk
	bool "VOIS No Trace"
	default y
	---help---
	   Trace for VOIS.

config EDRV_NO_TRACE
	option skipmk
	bool "EDRV No Trace"
	default y
	---help---
	   Trace for EDRV.

config CALIB_NO_PRINTF
	option skipmk
	bool "Calib No Trace"
	default y
	---help---
	   Trace for Calibration.

config UCTLS_NO_PRINTF
	option skipmk
	bool "Uctls No Trace"
	default y
	---help---
	   Trace for Uctls.

config UMSS_NO_PRINTF
	option skipmk
	bool "Umss No Trace"
	default y
	---help---
	   Trace for Umss.

config ARS_NO_PRINTF
	option skipmk
	bool "ARS No Trace"
	default y
	---help---
	   Trace for ARS.

config RFD_NO_TRACE
	option skipmk
	bool "RFD No Trace"
	default y
	---help---
	   Trace for RFD.

config BT_NO_PRINTF
	option skipmk
	bool "BT No Trace"
	default y
	---help---
	   Trace for BT.

#config I2C_REG_DEBUG
#	bool "I2C_REG_DEBUG"
#	default y
#	---help---
#	   Open the SPI register debug
#
#config CHIP_DIE_8809M_FOR_TEMP_TEST
#	option skipmk
#	bool "CHIP_DIE_8809M_FOR_TEMP_TEST"
#	default y
#
```

## soft/newfcfg/Kconfig.default
```kconfig
		
config MMI_ON_HARDWARE_P
	option skipmk
	bool "On Hardware"
	default y
	---help---
	   Run on hardware or not.

config CSD_TARGET
	option skipmk
	bool "Coolsand Target"
	default y
	---help---
	   Run on Coolsand Target.

config CSD_NEW_API
	option skipmk
	bool "CDS new api"
	default y
	---help---
	   Use the new api on CSD.

config CT_ROMULATOR
	option skiph
	bool "romulator"
	default n
    ---help---
         if CT_ROMULATOR is set to yes, the flash mapping emulated will be the one corresponding to the FLSH_MODEL selected for the CT_TARGET, this model can be overwritten by adding FLSH_MODEL=<model> to the make command line the actual driver used will be the romulator driver.

config USE_KCONFIG
	option skiph
	bool
	default y
```

## soft/newfcfg/application/Kconfig
```kconfig
comment "--- Application ---"

menu "Communication"
source "newfcfg/application/adaptation/communication/Kconfig"
endmenu

menu "Features"
source "newfcfg/application/Kconfig.features"
endmenu

menu "Resource"
source "newfcfg/application/target_res/Kconfig"
endmenu

menu "Compress"
source "newfcfg/application/Kconfig.compress"
endmenu

menu "Display"
source "newfcfg/application/Kconfig.display"
endmenu

menu "SIM"
source "newfcfg/application/Kconfig.sim"
endmenu

menu "diag && BBAT"
source "newfcfg/application/diag/Kconfig"
endmenu

menu "Device"
source "newfcfg/application/Kconfig.device"
endmenu

source "newfcfg/application/Kconfig.sensor"
source "newfcfg/application/Kconfig.key"
source "newfcfg/application/Kconfig.touch"

menu "Default Setup"
source "newfcfg/application/Kconfig.default"
endmenu
```

## soft/newfcfg/application/Kconfig.compress
```kconfig
comment "--- Compress Options ---"

config CT_COMPRESS_CODE_SECTION
    bool "CT_COMPRESS_CODE_SECTION"
    option skiph
    default y
    ---help---
        To support code compress.

config CT_COMPRESS_PREMAIN
    bool "CT_COMPRESS_PREMAIN"
    option skiph
    default y
    ---help---
        use compress before os init

config COMPRESS_OPTIMIZE_FLASH_SIZE
    bool "COMPRESS_OPTIMIZE_FLASH_SIZE"
    option skipmk
    default y
    ---help---
        use string resources compress

config COMPRESS_USE_LZMA
    bool "COMPRESS_USE_LZMA"
    option skipmk
    default y
    ---help---
        the algorithm used by string resources compress

if CT_COMPRESS_CODE_SECTION
choice COMPRESS_STATE_SEL
    option skiph
    option skipmk
    prompt "COMPRESS_STATE"
    default compress_state_3264
    ---help---
        different state used by memd.def file for zone user_data_size,user_data_base and so on info.
        if overlay is enabled, every state has its own overlay compress strategy

    config compress_state_3264
    option skiph
    option skipmk
    bool "3264"
    select COMPRESS_3264

    config compress_state_3232
    option skiph
    option skipmk
    bool "3232"
    select COMPRESS_3232

    config compress_state_3232_no_overlay
    option skiph
    option skipmk
    bool "3232_NO_OVERLAY"
    select COMPRESS_3232_NO_VOERLAY

    config compress_state_6464
    option skiph
    option skipmk
    bool "6464"
    select COMPRESS_6464

endchoice

config COMPRESS_STATE
    option skiph
    string
    default "3264" if compress_state_3264
    default "3232" if compress_state_3232
    default "3232_NO_OVERLAY" if compress_state_3232_no_overlay
    default "6464" if compress_state_6464

config COMPRESS_3264
    bool
    option skipmk
    default y if compress_state_3264
    default n

config COMPRESS_3232
    bool
    option skipmk
    default y if compress_state_3232
    default n

config COMPRESS_3232_NO_OVERLAY
    bool
    option skipmk
    default y if compress_state_3232_no_overlay
    default n

config COMPRESS_6464
    bool
    option skipmk
    default y if compress_state_6464
    default n

config COMPRESS_3264_USE_OVERLAY
    bool "Compress 3264 use overlay"
    option skipmk
    depends on COMPRESS_3264 && CT_COMPRESS_3264_USE_OVERLAY
    default y

config __CODE_DECOMPRESS_WITH_VOC__
    bool "Code decompress with voc"
    option skipmk
    default y
    ---help---
        enable this config,decompress code wit voc , otherwise decompress with cpu.

config COMPRESS_PREMAIN
    bool
    option skipmk
    depends on CT_COMPRESS_PREMAIN
    default y
    ---help---
        use compress before os init
endif

if !CT_COMPRESS_CODE_SECTION
config VOCCODE_IN_PSRAM
    bool "VOCCODE_IN_PSRAM"
	option skipmk
	default y
	---help---
	   if not enable code compress, voc code should put in sram. Otherwise, will cause system crash.

endif
```

## soft/newfcfg/application/Kconfig.default
```kconfig
comment "--- Default Options ---"

config __EM_MODE__
	option skipmk
	def_bool y

config __GSM_MODE__
	option skipmk
	def_bool y

config __UCS2_ENCODING 
	option skipmk
	def_bool y

config __FF_AUDIO_SET__
	option skipmk
	def_bool y

config __MCD__
	option skipmk
	def_bool y

config __SAT__
	option skipmk
	def_bool y

config __VIBRATOR__
	option skipmk
	bool
	default y

config __MOD_CSM__ 	
	option skipmk
	def_bool y

config __MOD_NVRAM__ 
	option skipmk
	def_bool y

config __MOD_ORGANIZER__
	option skipmk
	def_bool y

config __MOD_PHB__ 	
	option skipmk
	def_bool y

config __MOD_RAC__ 	
	option skipmk
	def_bool y

config __MOD_SIM__ 	
	option skipmk
	def_bool y

config __MOD_SMS__ 	
	option skipmk
	def_bool y

config __MOD_SMSAL__ 
	option skipmk
	def_bool y

config __MMI_MESSAGE_DIFFERENTIATE_STORAGE__
	option skipmk
	def_bool y if __MOD_SMSAL__ && !(__MMI_R_WATCH_KIDS__)
	def_bool n

config __MMI_MESSAGES_CONCAT_SMS__
	option skipmk
	def_bool y if __MOD_SMSAL__ && !(__MMI_R_WATCH_KIDS__)
	def_bool n

config __MMI_MESSAGES_TEMPLATE__
	option skipmk
	def_bool y if __MOD_SMSAL__ && !(__MMI_R_WATCH_KIDS__)
	def_bool n

config __MMI_MESSAGES_PREFER_STORAGE_MEMORY_STATUS__
	option skipmk
	def_bool y if __MOD_SMSAL__ && !(__MMI_R_WATCH_KIDS__)
	def_bool n

config __MMI_MESSAGES_SEND_BY_GROUP__
	option skipmk
	def_bool y if __MOD_SMSAL__ && !(__MMI_R_WATCH_KIDS__)
	def_bool n

config __MMI_MESSAGES_SEND_TO_MANY__
	option skipmk
	def_bool y if __MOD_SMSAL__ && !(__MMI_R_WATCH_KIDS__)
	def_bool n

config __MMI_MESSAGES_SEND_TO_MANY_BY_LIST__
	option skipmk
	def_bool y if __MOD_SMSAL__ && !(__MMI_R_WATCH_KIDS__)
	def_bool n

config __MMI_MESSAGES_INSERT_FROM_PHB__
	option skipmk
	def_bool y if __MOD_SMSAL__ && !(__MMI_R_WATCH_KIDS__)
	def_bool n

config _MUTILANG_TEMPLATE_
	option skipmk
	def_bool y if __MOD_SMSAL__ && !(__MMI_R_WATCH_KIDS__)
	def_bool n

config __MMI_MESSAGES_CONTINUE_SEND_AFTER_FAIL__
	option skipmk
	def_bool y if __MMI_MESSAGES_SEND_TO_MANY__ || __MMI_MESSAGES_SEND_BY_GROUP__
	def_bool n

config __MOD_SMU__ 	
	option skipmk
	def_bool y

config __MOD_UEM__ 
	option skipmk
	def_bool y

config __MED_MMA_MOD__
	option skipmk
	def_bool y

config __MMI_IMAGE_VIEWER__
	option skipmk
	def_bool y

config __MMI_MERGE_SAT_TO_MAINMENU__
	option skipmk
	def_bool y

config VM_SUPPORT
	option skipmk
	def_bool y

config SIM_APP_TOOLKIT
	option skipmk
	def_bool y

config AAC_DECODE
	option skipmk
	def_bool y

config __MMI_RESOURCE_SLIM__
	option skipmk
	def_bool y

#config MESSAGES_APPLICATION
#	option skipmk
#	bool
#	default y
#
config JPG_DECODE_USING_SOFTWARE
	option skipmk
	def_bool y

config JPG_DECODE
	option skipmk
	def_bool y

config PHB_REJECTCALL_NO_RECORD_AND_MENU
	option skipmk
	def_bool y

config __MMI_MSG_MEMORY_STATUS_DISPLAY_NUM__
	option skipmk
	def_bool y
```

## soft/newfcfg/application/Kconfig.device
```kconfig
config ADP_EARPIECE_DET_DEBOUNCE
	option skipmk
	bool	"ADP_EARPIECE_DET_DEBOUNCE"
	default y
	---help---
		debounce process when earpiece pluged out or in, for wrong info when earpiece  pluged out or in

config SUPPORT_EP_WITHOUT_MIC
    option skipmk
    bool "SUPPORT_EP_WITHOUT_MIC"
    default y
    ---help---
    	support the earphone without MIC or not.

config __TFLASH_MOUNT_DYNAMIC__
    option skipmk
    bool "TFLASH_MOUNT_DYNAMIC"
    default n
    ---help---
    	T-flash supports hotplug or not.

config HW_MELODY_MOTOR
	option skipmk
	bool	"HW_MELODY_MOTOR"
	default n
	---help---
		if aud 3 in 1 spk is configured, this should configured to yes
```
