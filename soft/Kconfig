## soft/newfcfg/application/Kconfig.display
```kconfig
#comment "--- Display Options ---"

choice
	option skiph
	option skipmk
	prompt "lcd size"
	default LCDSIZE_128_160
	---help---
		LCDSIZE_128_160/LCDSIZE_176_220/LCDSIZE_240_320

	config LCDSIZE_128_128
		option skipmk
		bool	"LCDSIZE_128_128"

	config LCDSIZE_128_160
		option skipmk
		bool	"LCDSIZE_128_160"

	config LCDSIZE_160_128
		option skipmk
		bool	"LCDSIZE_160_128"

	config LCDSIZE_176_220
		option skipmk
		bool	"LCDSIZE_176_220"

	config LCDSIZE_240_320
		option skipmk
		bool	"LCDSIZE_240_320"

	config LCDSIZE_240_240
		option skipmk
		bool	"LCDSIZE_240_240"

	config LCDSIZE_320_240
		option skipmk
		bool	"LCDSIZE_320_240"
endchoice

config __MMI_MAINLCD_128X128__
	option skipmk
	bool "MMI_MAINLCD_128X128"
	def_bool y if LCDSIZE_128_128
	def_bool n

config __MMI_MAINLCD_128X160__
	option skipmk
	bool "MMI_MAINLCD_128X160"
	def_bool y if LCDSIZE_128_160
	def_bool n

config __MMI_MAINLCD_160X128__
	option skipmk
	bool "MMI_MAINLCD_160X128"
	def_bool y if LCDSIZE_160_128
	def_bool n

config __MMI_MAINLCD_240X320__
	option skipmk
	bool "MMI_MAINLCD_240X320"
	def_bool y if LCDSIZE_240_320
	default n

config __MMI_MAINLCD_176X220__
	option skipmk
	bool "MMI_MAINLCD_176X220"
	def_bool y if LCDSIZE_176_220
	default n

config __MMI_MAINLCD_220X176__
	option skipmk
	bool "MMI_MAINLCD_220X176"
	def_bool y if LCDSIZE_220_176
	default n

config __MMI_MAINLCD_240X240__
	option skipmk
	bool "MMI_MAINLCD_240X240"
	def_bool y if LCDSIZE_240_240
	default n

config __MMI_MAINLCD_320X240__
	option skipmk
	bool "MMI_MAINLCD_320X240"
	def_bool y if LCDSIZE_320_240
	default n
#config __MMI_USE_DM_VOLUME_LEVEL_DISPLAY__
#	bool "MMI_USE_DM_VOLUME_LEVEL_DISPLAY"
#	option skipmk
#	default y
#	---help---
#	TO DO
#
#config __MMI_ONLY_2_LAYER__
#	bool "MMI_ONLY_2_LAYER"
#	option skipmk
#	default y
#
#config __MMI_FULL_KEYPAD__
#	bool "MMI_FULL_KEYPAD"
#	option skipmk
#	default n
#
#config __MMI_WITH_IME_KEY__
#	option skipmk
#	bool "MMI_WITH_IME_KEY"
#	depends on __MMI_FULL_KEYPAD__
#	default n
#
#config __MMI_NUMBER_MENU__
#	option skipmk
#	bool "MMI show number menu"
#	default y
#
#config __MMI_DRAW_MANAGER__
#	option skipmk
#	bool "MMI enable draw manager"
#	default y
#
#config __GDI_MEMORY_PROFILE_2__
#	option skipmk
#	bool "GDI support multilayer"
#	default y
#	---help---
#	__GDI_MEMORY_PROFILE_2__ is used to decide whether multilayer is on or off. If multilayer is enable, no buffer is used. We can use one layer for keypad bg image, and another for selected keys.
#
#config __MMI_UI_STYLE_2__
#	option skipmk
#	def_bool y if __MMI_MAINLCD_128X160__
#
#config __MMI_UI_STYLE_3__
#	option skipmk
#	def_bool y if __MMI_MAINLCD_176X220__ || __MMI_MAINLCD_220X176__
#
#config __MMI_UI_STYLE_4__
#	option skipmk
#	def_bool y if __MMI_MAINLCD_240X320__
#
#config __MMI_UI_STYLE_1__
#	option skipmk
#	def_bool y if !(__MMI_MAINLCD_128X128__ || __MMI_MAINLCD_128X160__ || __MMI_MAINLCD_176X220__ || __MMI_MAINLCD_220X176__ || __MMI_MAINLCD_240X320__)
#
#config __MMI_UI_LIST_HIGHLIGHT_EFFECTS__
#	option skipmk
#	bool "MMI list effect type"
#	default n
#
#config __MMI_UI_TRANSPARENT_EFFECT__
#	option skipmk
#	def_bool y if __MMI_UI_LIST_HIGHLIGHT_EFFECTS__
#
#config __MMI_UI_SOFTKEY_DEFAULT_STYLE_2__
#	option skipmk
#	def_bool y if __MMI_MAINLCD_128X160__ || __MMI_MAINLCD_176X220__ || __MMI_MAINLCD_220X176__ || __MMI_MAINLCD_240X320__ || __MMI_MAINLCD_240X240__
#
#config __MMI_UI_SOFTKEY_DEFAULT_STYLE_2__
#	option skipmk
#	def_bool y if !(__MMI_MAINLCD_128X160__ || __MMI_MAINLCD_176X220__ || __MMI_MAINLCD_220X176__ || __MMI_MAINLCD_240X320__ || __MMI_MAINLCD_240X240__)
#
#config __MMI_IDLE_FULL_SCREEN__
#    option skipmk
#    bool "MMI full screen display when idle"
#    default y
#
#config __MMI_KEYPAD_LOCK_PATTERN_1__
#    option skipmk
#    bool "Define keypad lock pattern as RSK (Name)->#"
#    default y
#
#config __MMI_UI_DALMATIAN_STATUSBAR__
#	option skipmk
#	bool "MMI UI Dalmatian for statusbar"
#	def_bool y if !__MMI_WGUI_CSK_ENABLE__ && __MMI_UI_DALMATIAN_IDLESCREEN__
#	def_bool n
#
#config __MMI_UI_DALMATIAN_SOFTKEYS__
#	option skipmk
#	bool "MMI UI Dalmatian for softkeys"
#	def_bool y if !__MMI_WGUI_CSK_ENABLE__ && __MMI_UI_DALMATIAN_IDLESCREEN__
#	def_bool n
#
#config __MMI_UI_MM_LIST_NO_GRID__
#	option skipmk
#	bool "MMI UI Do not draw grid on List main menu"
#	def_bool y if __MMI_UI_DALMATIAN_FIXEDLIST__
#	def_bool n
#
#config __MMI_UI_TAB_PANE__
#	option skipmk
#	bool "Tab pane based mainmenu support"
#	def_bool y if __MMI_MAINMENU_TAB_SUPPORT__
#	def_bool n
#
#config __MMI_UI_TITLE_TRANSITION__
#	option skipmk
#	bool "Tab pane based mainmenu support"
#	def_bool y if __MMI_MAINMENU_TAB_SUPPORT__
#	def_bool n

config LCD_SCALE_128_160_TO_176_220
	option skipmk
	bool "LCD Scale 128x160 to 176x220"
	default n
	---help---
		LCD support to scale 128*160 to 176*220.

config LCD_QVGA_USED_AS_QQVGA
	option skipmk
	bool "LCD QVGA use as QQVGA"
	default n
	---help---
		LCD support to scale QVGA to QQVGA.

config __MMI_USE_DRAW_FOCUS_IN_MAINMENU__
	option skipmk
	bool "__MMI_USE_DRAW_FOCUS_IN_MAINMENU__"
	default n
	---help---
		MMI support draw the focus background in mainmenu.

config __MMI_USING_BLACK_THEME_BG__
	option skipmk
	bool "__MMI_USING_BLACK_THEME_BG__"
	default y
	---help---
		MMI supports black theme or not.

config __DISPLAY_POWERON_LOGO__
    option skipmk
    bool "DISPLAY_POWERON_LOGO"
    default n
    ---help---
    	Display poweron logo before task init.
```

## soft/newfcfg/application/Kconfig.features
```kconfig
menu "Call"
source "newfcfg/application/coolmmi/mmi/calls/Kconfig"
source "newfcfg/application/coolmmi/mmi/callmanagement/Kconfig"
endmenu

menu "Messages"
source "newfcfg/application/coolmmi/mmi/messages/Kconfig"
endmenu

menu "Phonebook"
source "newfcfg/application/coolmmi/mmi/phonebook/Kconfig"
endmenu

menu "Profiles & Settings"
source "newfcfg/application/coolmmi/mmi/profiles/Kconfig"
source "newfcfg/application/coolmmi/mmi/setting/Kconfig"
endmenu

menu "Idlescreen"
source "newfcfg/application/coolmmi/mmi/idlescreen/Kconfig"
endmenu

menu "Watch"
source "newfcfg/application/coolmmi/mmi/rwatch/Kconfig"
endmenu

menu "Multimedia"

menu "Radio"
source "newfcfg/application/coolmmi/mmi_csdapp/fmradio/Kconfig"
endmenu
menu "Audio"
source "newfcfg/application/coolmmi/mmi_csdapp/audioplayer/Kconfig"
endmenu
menu "Video"
source "newfcfg/application/coolmmi/mmi_csdapp/video/Kconfig"
endmenu
menu "Camera"
source "newfcfg/application/coolmmi/mmi_csdapp/camera/Kconfig"
endmenu
menu "SoundRecorder"
source "newfcfg/application/coolmmi/mmi/soundrecorder/Kconfig"
endmenu
menu "ATV"
source "newfcfg/application/coolmmi/mmi_csdapp/analogtv/Kconfig"
endmenu

endmenu

menu "FileManagement"
source "newfcfg/application/coolmmi/mmi_csdapp/filemgr/Kconfig"
endmenu

menu "Wap & MMS"
source "newfcfg/application/coolmmi/mmi/wapmms/Kconfig"
endmenu

menu "Bluetooth"
source "newfcfg/application/coolmmi/mmi/bluetooth/Kconfig"
endmenu

menu "USB"
source "newfcfg/application/coolmmi/mmi/usb/Kconfig"
endmenu

menu "Organizer"
source "newfcfg/application/coolmmi/mmi/organizer/Kconfig"
endmenu

menu "EngineerMode"
source "newfcfg/application/coolmmi/mmi_csdapp/engineermode/Kconfig"
endmenu
```

## soft/newfcfg/application/Kconfig.key
```kconfig
menu "Key"

config __MMI_NO_SIDEKEY__
	option skipmk
	bool "No side key"
	default y
	---help---
		MMI support no sidekey. Pound key and asterisk key can instead of side key.

config __NO_SIDE_VOLUME_KEY_STAR_POUND__
	option skipmk
	def_bool y if __MMI_NO_SIDEKEY__
	def_bool n

config __MMI_CAMERA_KEY__
	option skipmk
	bool "Camera key"
	default n
	---help---
		MMI support a speical camera key.

config __MMI_USE_LSK_AS_SEND2__
    option skipmk
    bool "__MMI_USE_LSK_AS_SEND2__"
    default n
    ---help---
    	MMI support Left softkey instead of dail key when dual SIM cards.

endmenu
```

## soft/newfcfg/application/Kconfig.sensor
```kconfig
menu "Sensor"

config MOTION_SENSOR_SUPPORT
	option skipmk
	bool "Motion Sensor"
	default n

config MMI_SUPPORT_GSENSOR
    option skiph
    bool "MMI_SUPPORT_GSENSOR"
    default n
endmenu
```

## soft/newfcfg/application/Kconfig.sim
```kconfig
comment "--- SIM Options ---"

config ADP_SIM_NUMBER
	option skipmk
	int
	default NUMBER_OF_SIM
	---help---
		It defines the number of SIM for adaptation. It must be same as NUMBER_OF_SIM.

config MMI_SIM_NUMBER
	option skipmk
	int "MMI Sim Number"
	default NUMBER_OF_SIM
	---help---
		It defines the number of SIM for MMI. It must be same as NUMBER_OF_SIM.

config __MMI_MULTI_SIM__
	option skipmk
	bool
	default y 
	---help---
		This option supports multi SIM cards in MMI. It must be YES if SIM number is not 1.

config __ADP_MULTI_SIM__
	option skipmk
	bool
	default y
	---help---
		This option supports multi SIM cards in ADP. It must be YES if SIM number is not 1.

config __MMI_DUAL_SIM_SINGLE_OPENED__
	option skipmk
	bool "DUAL_SIM_SINGLE_OPENED"
	default n
	---help---
	    This option supports showing one SIM with Dual SIM platform. 

config MMI_SUPPORT_SENDKEY2
	option skiph
	depends on MMI_SIM_NUMBER = 2
	bool "MMI_SUPPORT_SENDKEY2"
	default n
	---help---
		This option supports the seconde call key for 2C2D1T dual mode.

config __SENDKEY2_SUPPORT__
	option skipmk
	def_bool y if MMI_SUPPORT_SENDKEY2
	def_bool n

config __MMI_RENAME_SIM__
	option skipmk
	bool "__MMI_RENAME_SIM__"
	default n
	---help---
		This option supports rename SIM.


menuconfig SUPPORT_SIMCARD_HOT_DETECT
    option skipmk
    bool "SUPPORT_SIMCARD_HOT_DETECT"
    default n
    ---help---
    SIM HOt Detect Support Function
    
if SUPPORT_SIMCARD_HOT_DETECT
config SIMCARD_HOT_DETECT
	option skipmk
	int "SIMCARD_HOT_DETECT"
	default 1
	---help---
		It defines which SIM card support hot detect.
		
config SIMCARD_DETECT_GPIO
	option skipmk
	string "SIMCARD_DETECT_GPIO"
	default HAL_GPIO_3
	---help---
		It defines which GPIO used as SIM hot detect.		
endif
```

## soft/newfcfg/application/Kconfig.touch
```kconfig
menuconfig TOUCHPANEL_SUPPORT
	option skipmk
	option skiph
	default n
	bool "Touch Panel"

if TOUCHPANEL_SUPPORT

comment "--- Touch Panel Options ---"

config TOUCH_PANEL_SUPPORT
	option skipmk
	bool "Touch panel support"
	default n

config MMI_SUPPORT_TOUCHPANEL
    option skiph
    bool
    default n

config __MMI_TOUCH_SCREEN__
	option skipmk
	bool "Touch panel MMI display"
	depends on TOUCH_PANEL_SUPPORT
	def_bool y

config __MMI_TOUCH_DIAL_SCREEN__
	option skipmk
	bool "Touch panel displays dial screen"
	depends on __MMI_TOUCH_SCREEN__
	def_bool y

config __MMI_PENPOWER__
	option skipmk
	bool "Enable HandWritting"
	depends on __MMI_TOUCH_SCREEN__
	def_bool y

config __MMI_WGUI_CSK_ENABLE__
	option skipmk
	bool "Enable Center Key"
	depends on __MMI_TOUCH_SCREEN__
	def_bool y if __MMI_MAINLCD_176X220__ || __MMI_MAINLCD_240X320__ || __MMI_MAINLCD_220X176__

config __MMI_NUMPAD_VK__
	option skipmk
	bool "New Virtual Keyboard"
	depends on __MMI_TOUCH_SCREEN__
	def_bool y if __MMI_MAINLCD_240X240__
    ---help---
    	support Nine number keypad Virtual keyboard. 
    	
config __MMI_RWATCH_CALL_MANAGEMENT__
	option skipmk
	bool "Call Touch Panel"
	depends on __MMI_TOUCH_SCREEN__
	def_bool y if __MMI_MAINLCD_240X240__
    ---help---
    	support call touch panel. 
    	    	
endif 
```

## soft/newfcfg/application/adaptation/communication/Kconfig
```kconfig
comment "--- application/communication ---"

config __DCS1800__
    option skipmk
    bool "DCS1800"
    default y
    ---help---
        To support RF band DCS1800.

config __EGSM900__
    option skipmk
    bool "EGSM900"
    default y
    ---help---
        To support RF band EGSM900.

config __GSM850__
    option skipmk
    bool "GSM850"
    default y
    ---help---
        To support RF band GSM850.

config __PCS1900__
    option skipmk
    bool "PCS1900"
    default y
    ---help---
        To support RF band PCS1900.
```
